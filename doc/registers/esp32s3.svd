# ESP32S3_RADIO register map
File version: 0.1.0
Undocumented ESP32-S3 radio registers as esp-sdr-zephyr knows them, additions to Espressif's SVD (github.com/espressif/svd at be20aa1): doc/registers/svdmerge.py merges them, doc/registers/svd2md.py renders doc/undocumented-registers-esp32s3.md. Peripherals in group ANALOG_I2C are analog I2C blocks, not memory-mapped: base address block << 8, one 8-bit register per offset.
Registers are 32-bit, read-write, no defined reset value unless marked. A register's access mark holds for its fields unless they carry their own. Offsets are from the block's base; lines under a group give offsets from that group; [hi:lo] are bit positions; {n}, {i} and the like mark numbered series; 'fields as' and 'values as' point back to an identical list; <NAME> marks a mode.

## Memory map
0x00006100 ULP size 0x9 — Analog I2C block 0x61 (ULP) One bit of this block takes part in the RC calibration of block 0x6a.
0x00006200 RFPLL size 0xD — Analog I2C block 0x62 (RF PLL) The RF PLL's VCO and its calibration. The library reads RFPLL_VCO_WINDOW after every tune. The capacitor code is `0x62:5 | 0x62:7[2] << 8` (9 bits; the vendor clamps to 0x1ff); a higher code means a lower VCO frequency. - After `set_rf_freq_offset()` the code is a manual one: `rfpll_cap_init_cal()` tries about 10 codes on either side of the calibrated one and keeps the average of those that read in-window (*decompile* S3 `phy_rfpll.o`). - The Wi-Fi PHY's temperature tracking (`rfpll_cap_track()`, after a change of 10 temperature units by default) reruns `rfpll_cap_correct()`, so the code can move after a tune (*decompile* S3 `phy_track.o`). - Upstream esp-sdr does a manual 512-code search on the ESP32-S2 through the same fields (`0x62:1`, `0x62:2[4]`, `0x62:11[6]`, `0x62:0[7]`, and `0x62:12[3:2]` as the window indication); it does not apply it to the S3 or the C6 (*upstream* `modules/lib/esp-sdr/main/targets/esp32s2/pll.h:8-36`).
0x00006300 RFPLL_SDM size 0x6 — Analog I2C block 0x63 (RF PLL fractional-N divider) The S3 sets the PLL frequency through registers 0 and 3 to 5: `f_PLL = 0.75 * f_xtal * (32 + r3 + r4 / 2^8 + r5 / 2^16)` With the 40 MHz crystal that is 30 MHz per integer step and about 458 Hz per LSB. `write_rfpll_sdm()` writes reg 0 = 0x07, regs 3 to 5, then reg 0 = 0x17 (bit 4 presumably loads the word). | PLL MHz | reg 3 | reg 4 | reg 5 | Decoded | |---|---|---|---|---| | 2412 | 0x30 | 0x66 | 0x66 | 30 MHz x 80.4 | | 2500 | 0x33 | 0x55 | 0x55 | 30 MHz x 83.33 | | 2700 | 0x3a | 0x00 | 0x00 | 30 MHz x 90 | Evidence: *decompile* S3 `phy_rfpll.o` (`rfpll_set_freq()`), S3 `phy_rfpll.o` (`write_rfpll_sdm()`); *measured* bench 2026-10-09: the raw values match the formula exactly. The crystal selector of the vendor calls picks the divisor, as on the C6: 1 = 26 MHz, 2 = 32 MHz, anything else = 40 MHz (*decompile* S3 `phy_rfpll.o`).
0x00006500 CKGEN size 0x9 — Analog I2C block 0x65 (clock generator, LO 5/6 divider) Register 0 bit 4 (mask 0x10) selects the LO 5/6 divider. The ESP32-C6 has no block 0x65; its selector is in block 0x62. - The S3 libphy and librftest objects only read block 0x65 in their debug dump (*decompile* S3 `phy_debug.o`). - Upstream qualifies the selector on the ESP32, S2, S3, C2, C3 and C6 and warns that the C5, C61, H2 and S31 lay out their analog blocks differently (`modules/lib/esp-sdr/docs/rx-controls.md:102-107`).
0x00006600 BBPLL size 0xB — Analog I2C block 0x66 (BBPLL) Documented by the HAL. Upstream's never-released `SAMPLE_RATE_PROBE` builds write `0x66:4[3:2]` (`I2C_BBPLL_DIV_ADC`) around a capture to look for other ADC rates and record no result (*upstream* `modules/lib/esp-sdr/main/targets/esp32s3/receiver.c:140-155`). esp_sdr does not touch the block.
0x00006700 BBTOP size 0x39 — Analog I2C block 0x67 (BBTOP, analog baseband) esp_sdr writes the receive and transmit filter codes here. - BBTOP_R4 and BBTOP_R6 both reading 0x10 is the vendor's sign that BBTOP lost its state; it then reruns its init (*decompile* S3 `phy_i2c.o`). - Writing the other pairs (0x06/0x07 up to 0x1e/0x1f) disturbed reception until a reboot (*measured* bench 2026-10-06). `esp_sdr_bbtop_read()` and `esp_sdr_bbtop_write()` give unchecked access (`lib/esp_sdr/src/esp_sdr_rx.c:648-667`). - The PHY's channel bandwidth mode changes these filters too (hardware-quirks.md, "40 MHz mode widens the analog filters"). Registers 0x24 to 0x38 (36 to 56) take init constants, bits 7:0 (*decompile* S3 `phy_i2c.o`): | Registers | Value | |---|---| | 0x24, 0x28 | 0x48 | | 0x25, 0x29 | 0x08 | | 0x2c, 0x2d, 0x30, 0x31 | 0x88 | | 0x34, 0x35 | 0x11 | | 0x38 | 0xff |
0x00006A00 BIAS size 0x8 — Analog I2C block 0x6a (bias): RC calibration Not used by esp_sdr. `get_rc_dout(mode)` measures an on-chip RC time constant: it writes `0x6a:2[6:5]` = 2, `0x6a:6[4:0]` = 2, `0x6a:4[7:4]` = 7, 11 or 6 by mode, `0x61:8[2]` = 1 and `0x6a:4[0]` = 1, pulses `0x6a:4[3]`, waits 100 us, reads `0x6a:5[5:0]` and clears `0x61:8[2]` and `0x6a:4[0]`. `rc_cal()` turns the result into the receive filter base code, `clamp((dout + 56) * 82 / 190 - 8, 2, 63)`, so the filter codes follow process spread. Evidence: *decompile* S3 `phy_analog_cal.o`.
0x60006000 FE size 0x178 — Front end The FE block, `DR_REG_FE_BASE` 0x60006000: the HAL has the base, no registers.
0x60008000 RTC_CNTL blocks up to offset 0x124 — USB PHY select
0x6000E000 I2C_ANA_MST size 0x174 — Analog I2C master Base 0x6000e000. The HAL defines only 0x6000e040 (`I2C_MST_ANA_CONF0_REG`), bits 17 and 18 of 0x6000e044 (`ANA_CONFIG_REG`) and bit 16 of 0x6000e048 (`ANA_CONFIG2_REG`) (`modules/hal/espressif/components/soc/esp32s3/include/soc/regi2c_defs.h:12-26`). The names I2C0_CTRL and I2C1_CTRL are the ESP32-C6 HAL's for its command registers. **Frequency hop engine** (*speculative* field meanings, *decompile* flow). The S3 PHY can tune Wi-Fi channels with a hardware I2C sequencer in this block instead of a software calibration. `set_channel_rfpll_freq()` takes this path when `phy_param + 0x120` bit 5 is set, which `get_rf_freq_init()` does at PHY init after filling an 85-entry table (2400 to 2484 MHz, capacitor codes interpolated between calibrations at 2400 and 2464 MHz); otherwise it calls `set_rf_freq_offset()`. So `set_chanfreq()` on a channel frequency probably loads a table entry without a fresh VCO calibration (S3 `phy_rfpll.o`, `phy_hw_freq.o`). Its registers are I2C_ANA_MST_HOP_CTRL_REG, I2C_ANA_MST_R130_REG, I2C_ANA_MST_HOP_WDATA_REG, I2C_ANA_MST_R150_REG and I2C_ANA_MST_R170_REG.
0x6001C000 AGC blocks up to offset 0x84 — AGC force
0x6001D000 BB blocks up to offset 0x64 — Baseband Leads, none tried: a spur notch and CCA busy counters that could take work off the CPU.
0x60033000 DUMP blocks up to offset 0xD94 — Dump and DAC engine The Wi-Fi MAC's debug dump engine moves raw baseband words between the radio and one 64 KiB SRAM bank (see "SRAM bank ownership"). Its page, 0x60033000, has no name in the HAL. Layout from upstream esp-sdr; the DAC side from librftest's `dactrig()`. **Wi-Fi MAC interrupt.** CPU interrupt line 0 (`ETS_WMAC_INUM`, `modules/hal/espressif/components/soc/esp32s3/include/soc/soc.h:212`); `esp_sdr_ring_run()` disables it on its CPU (hardware-quirks.md, "Capture and DAC engine"; `lib/esp_sdr/src/esp_sdr_ring.c:462-491`).
0x600C1000 SENSITIVE blocks up to offset 0x20 — SRAM bank ownership

## Notices in the file
SPDX-License-Identifier: GPL-3.0-or-later
