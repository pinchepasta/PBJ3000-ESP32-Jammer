## CMakeLists.txt
```
# SPDX-License-Identifier: GPL-3.0-or-later

cmake_minimum_required(VERSION 3.20.0)

find_package(Zephyr REQUIRED HINTS $ENV{ZEPHYR_BASE})
project(esp_sdr_link)

include(${CMAKE_CURRENT_LIST_DIR}/../common/common.cmake)

target_sources(app PRIVATE
  src/main.c
  src/mac.c
  src/perf.c
  src/qam.c
  src/rs.c
  src/hamming.c
  src/ofdm.c
  src/ofdm_frame.c
  src/ofdm_test.c)
target_compile_definitions(app PRIVATE QAM_SPS=${CONFIG_APP_SPS})
# Per-sample and per-byte loops of the modem and the codec. Zephyr's ISO C
# mode turns contraction off: fused multiply-adds halve the FPU work.
set_source_files_properties(src/qam.c src/ofdm.c PROPERTIES COMPILE_OPTIONS "-O3;-ffp-contract=fast")
set_source_files_properties(src/rs.c src/hamming.c PROPERTIES COMPILE_OPTIONS -O3)

# Only the ESP32-S3 float FFT kernel of esp-dsp: its IDF scaffolding stays out.
if(CONFIG_APP_OFDM_ESP_DSP)
  set(ESP_DSP_DIR "${WEST_TOPDIR}/modules/lib/esp-dsp")
  set(ESP_DSP_FFT "${ESP_DSP_DIR}/modules/fft/float/dsps_fft2r_fc32_aes3_.S")
  if(NOT EXISTS "${ESP_DSP_FFT}")
    message(FATAL_ERROR "esp-dsp not found at ${ESP_DSP_DIR} (west project esp-dsp)")
  endif()
  target_sources(app PRIVATE "${ESP_DSP_FFT}")
  # Its platform header enables the S3 kernel by the IDF target macro.
  set_source_files_properties("${ESP_DSP_FFT}" PROPERTIES
    COMPILE_DEFINITIONS CONFIG_IDF_TARGET_ESP32S3=1
    INCLUDE_DIRECTORIES "${ESP_DSP_DIR}/modules/fft/include")
endif()
```

## Kconfig
```
# SPDX-License-Identifier: GPL-3.0-or-later

mainmenu "ESP-SDR link"

config APP_FREQ_MHZ
	int "Carrier frequency in MHz"
	range 100 6000
	default 2412

config APP_TX_GAIN
	int "Transmit power step at boot (0 weakest)"
	range 0 17
	default 0

config APP_RX_GAIN
	int "Receive gain index at boot (-1: hardware AGC)"
	range -1 82
	default 0
	help
	  A fixed gain keeps the level steady across a capture; the AGC
	  reacts to the frame itself.

config APP_SPS
	int "Samples per symbol (even)"
	range 4 16
	default 4
	help
	  At 80 MS/s: 4 is 20 Mbaud (27 MHz occupied), 6 is 13.3 Mbaud
	  (18 MHz). With the PHY in its 20 MHz mode (APP_CBW 0) the analog
	  filters pass about +-10 MHz, where 6 fits better. Both ends must
	  agree.

config APP_CBW
	int "PHY channel bandwidth flag (esp_sdr_set_channel_bw())"
	range 0 2
	default 2
	help
	  2 widens the analog filters past +-10 MHz (measured: -14 instead of
	  -21 dB at 11 MHz) and lifts the MER by about 1.5 dB at 20 Mbaud.

config APP_RX_BW_MHZ
	int "Receive filter bandwidth in MHz (0: widest, -1: the PHY's setting)"
	range -1 69
	default 0
	help
	  Otherwise 13 to 69 MHz (1 to 12 fail the build). The PHY's own
	  setting is about 22 MHz wide, narrower than the
	  27 MHz the 20 Mbaud signal occupies.

config APP_AMP
	int "RMS amplitude of a frame in DAC steps"
	range 1 300
	default 150

config APP_DATA_AIR_US
	int "Time a data frame stays on air, in us"
	default 700
	help
	  The frame repeats in a loop for this long. It must cover a
	  listener's sense slot, its reaction and one full capture window
	  (205 us), so that the window holds one whole copy.

config APP_ACK_AIR_US
	int "Time an ACK stays on air, in us"
	default 700

config APP_ACK_TIMEOUT_US
	int "How long a sender listens for the ACK, in us"
	default 25000
	help
	  From the end of its frame: covers the receiver's capture, decode
	  and switch to transmit.

config APP_TURN_US
	int "Front end settling at each TX/RX switch, in us"
	range 0 3000
	default 3000
	help
	  esp_sdr_set_turnaround(). Each frame and each ACK switches twice,
	  so this bounds the frame rate of the stop and wait link.

config APP_TURN_RETUNE
	bool "Reprogram the LO at each TX/RX switch"
	default y

config APP_CCA_DB
	int "Carrier sense threshold above the noise floor, in dB"
	default 10

config APP_RADIO_CPU
	int "CPU of the MAC thread"
	range 0 1
	default 1

config APP_NET_CPU
	int "CPU for the system threads (-1: not pinned)"
	range -1 1
	default 0

config APP_BUILD_PRIORITY
	int "Frame builder thread priority (runs on APP_NET_CPU)"
	default 10

config APP_RX2_PRIORITY
	int "Priority of the second decoder of a pair (runs on APP_NET_CPU)"
	default 6

config APP_OFDM_BW_KHZ
	int "OFDM: occupied bandwidth (kHz)"
	default 26000

config APP_OFDM_CHANNELS
	int "OFDM: subcarriers"
	default 84

config APP_OFDM_FS_MHZ
	int "OFDM: transmit sample rate (MS/s, 80 or 40)"
	range 40 80
	default 40

config APP_OFDM_RX_DIV
	int "OFDM: receive at the transmit rate divided by this (1 or 2, at least 40 MS/s)"
	range 1 2
	default 1

config APP_OFDM_ESP_DSP
	bool "OFDM FFT: the esp-dsp ESP32-S3 kernel (modules/lib/esp-dsp)"
	default y
	help
	  Else the same radix-2 algorithm in C, in IRAM.

config APP_MAC_PRIORITY
	int "MAC thread priority"
	default 4

rsource "../common/Kconfig"

# USB device helpers shared with the in-tree USB samples.
source "samples/subsys/usb/common/Kconfig.sample_usbd"

source "Kconfig.zephyr"
```

## sample.yaml
```
sample:
  name: ESP-SDR link
  description: >-
    QAM link at the native 80 MS/s with Reed-Solomon coding, a CSMA/CA MAC
    and an iperf style throughput test on the USB shell
common:
  tags: esp-sdr
  sysbuild: true
  platform_allow:
    - xiao_esp32s3/esp32s3/procpu
  integration_platforms:
    - xiao_esp32s3/esp32s3/procpu
tests:
  # Two boards and a cabled link: run tools/link_perf.py (see README).
  sample.esp_sdr.link:
    build_only: true
```

## prj.conf
```kconfig
# The Wi-Fi driver brings the radio up at boot; nothing may scan or connect.
CONFIG_NETWORKING=y
CONFIG_WIFI=y
CONFIG_ESP32_WIFI_STA_POWER_SAVE_NONE=y

CONFIG_ESP_SDR=y
# Two dump banks: one plays the pending frame, the other captures and ACKs.
CONFIG_ESP_SDR_BANK1=y
# Native 80 MS/s only.
CONFIG_ESP_SDR_RX_DECIM=n

CONFIG_LOG=y
CONFIG_LOG_MODE_DEFERRED=y

CONFIG_FPU=y
CONFIG_FPU_SHARING=y
CONFIG_CBPRINTF_FP_SUPPORT=y
CONFIG_PICOLIBC_IO_FLOAT=y
CONFIG_MAIN_STACK_SIZE=2048

CONFIG_SMP=y
CONFIG_HWINFO=y
CONFIG_ENTROPY_GENERATOR=y

# USB device on the OTG port: shell on CDC-ACM, DFU with sysbuild/MCUboot.
CONFIG_USB_DEVICE_STACK_NEXT=y
CONFIG_SAMPLE_USBD_PRODUCT="ESP-SDR Link"
CONFIG_SAMPLE_USBD_PID=0x0005
CONFIG_USBD_LOG_LEVEL_WRN=y
CONFIG_UDC_DRIVER_LOG_LEVEL_WRN=y
CONFIG_USBD_THREAD_STACK_SIZE=2048
CONFIG_UDC_DWC2_STACK_SIZE=1280
CONFIG_USBD_CDC_ACM_CLASS=y
# CDC-ACM carries the console and the shell: its own logging must stay off (it would log to
# itself), which usbd_cdc_acm.c otherwise enforces with a #warning that -Werror makes fatal.
CONFIG_USBD_CDC_ACM_LOG_LEVEL_OFF=y
CONFIG_CDC_ACM_SERIAL_INITIALIZE_AT_BOOT=n

CONFIG_SHELL=y
CONFIG_KERNEL_SHELL=y
CONFIG_LOG_BACKEND_UART=n
CONFIG_SHELL_STACK_SIZE=3072
CONFIG_SHELL_CMD_BUFF_SIZE=128
CONFIG_SHELL_BACKEND_SERIAL_LOG_MESSAGE_QUEUE_SIZE=256
CONFIG_DEVICE_SHELL=n
CONFIG_DATE_SHELL=n
CONFIG_DEVMEM_SHELL=y
# Wi-Fi management commands would retune the radio under the MAC.
CONFIG_NET_L2_WIFI_SHELL=n

# Internal RAM: two 64 KiB dump banks must fit. The Wi-Fi heap goes to the
# 8 MB octal PSRAM.
CONFIG_ESP_SPIRAM=y
CONFIG_SPIRAM_MODE_OCT=y
CONFIG_ESP_WIFI_HEAP_SPIRAM=y
CONFIG_ESP32_WIFI_STATIC_RX_BUFFER_NUM=4
CONFIG_ESP32_WIFI_MGMT_SBUF_NUM=8
CONFIG_ESP32_WIFI_EVENT_TASK_STACK_SIZE=1024
CONFIG_NET_MGMT_EVENT_STACK_SIZE=1024
CONFIG_HEAP_MEM_POOL_IGNORE_MIN=y
# Peak 15.5 KB measured with "link mem".
CONFIG_HEAP_MEM_POOL_SIZE=17408
CONFIG_SYS_HEAP_RUNTIME_STATS=y

# A crash reboots into the confirmed image instead of halting with USB dead;
# "link status" shows the reset cause.
CONFIG_RESET_ON_FATAL_ERROR=y
# Experiments at the radio's limits: a hang resets instead of needing a replug.
CONFIG_APP_LIVENESS_WATCHDOG=y
```

## boards/xiao_esp32s3_procpu.overlay
```dts
/*
 * SPDX-License-Identifier: GPL-3.0-or-later
 */

/ {
	chosen {
		zephyr,console = &cdc_acm_uart0;
		zephyr,shell-uart = &cdc_acm_uart0;
	};
};

zephyr_udc0: &usb_otg {
	status = "okay";

	/* Console, shell and logs while OTG owns the USB port. */
	cdc_acm_uart0: cdc_acm_uart0 {
		compatible = "zephyr,cdc-acm-uart";
		label = "ESP-SDR link shell";
	};
};
```

## src/main.c
```c
/*
 * SPDX-License-Identifier: GPL-3.0-or-later
 *
 * QAM link at 80 MS/s with a CSMA/CA MAC and an iperf style test on the
 * shell ("link"). The MAC thread owns the radio on one CPU, the system
 * threads go to the other.
 */

#include <zephyr/app_version.h>
#include <zephyr/kernel.h>
#include <zephyr/logging/log.h>

#include "app_cpu.h"
#include "app_usb.h"
#include "mac.h"

LOG_MODULE_REGISTER(link, LOG_LEVEL_INF);

int main(void)
{
	printk("link %s\n", APP_VERSION_STRING);
	app_cpu_pin_system_threads(CONFIG_APP_NET_CPU);
	if (app_usb_init() != 0) {
		LOG_ERR("usb init failed");
	}
	if (link_mac_init() != 0) {
		LOG_ERR("mac init failed");
		return 0;
	}
	/* Again for the threads started since (usbd, UDC). */
	k_sleep(K_MSEC(500));
	app_cpu_pin_system_threads(CONFIG_APP_NET_CPU);
	return 0;
}
```

## src/hamming.c
```c
/*
 * SPDX-License-Identifier: GPL-3.0-or-later
 *
 * Data bit k (byte k / 8, bit k % 8) sits at code position pos[k], the k-th
 * of 1..127 that is not a power of two; the parity byte's bits 0..6 are the
 * check bits at positions 1, 2, 4, .., 64, and bit 7 is the overall parity.
 * The syndrome of a byte is looked up per byte position and nibble.
 */

#include "hamming.h"

/* Syndromes per byte position and nibble: 480 bytes instead of 3840. */
static uint8_t syn_lo[HAM_K][16], syn_hi[HAM_K][16];
/* Data bit at each code position, 0xff for the check bit positions. */
static uint8_t bit_at[128];

static unsigned int parity8(unsigned int v)
{
	v ^= v >> 4;
	v ^= v >> 2;
	v ^= v >> 1;
	return v & 1U;
}

void ham_init(void)
{
	uint8_t pos[HAM_K * 8];
	unsigned int k = 0;

	for (unsigned int p = 0; p < 128; p++) {
		bit_at[p] = 0xff;
	}
	for (unsigned int p = 3; p < 128; p++) {
		if ((p & (p - 1U)) != 0) {
			bit_at[p] = (uint8_t)k;
			pos[k++] = (uint8_t)p;
		}
	}
	for (unsigned int b = 0; b < HAM_K; b++) {
		for (unsigned int v = 0; v < 16; v++) {
			uint8_t lo = 0, hi = 0;

			for (unsigned int i = 0; i < 4; i++) {
				if (v & (1U << i)) {
					lo ^= pos[b * 8 + i];
					hi ^= pos[b * 8 + 4 + i];
				}
			}
			syn_lo[b][v] = lo;
			syn_hi[b][v] = hi;
		}
	}
}

static inline unsigned int data_syndrome(const uint8_t *blk, unsigned int *par)
{
	unsigned int s = 0, x = 0;

	for (unsigned int b = 0; b < HAM_K; b++) {
		s ^= syn_lo[b][blk[b] & 15U] ^ syn_hi[b][blk[b] >> 4];
		x ^= blk[b];
	}
	*par = parity8(x);
	return s;
}

void ham_encode(uint8_t *blk)
{
	unsigned int par, s = data_syndrome(blk, &par);

	/* Check bits equal the data syndrome, so the full syndrome is zero. */
	blk[HAM_K] = (uint8_t)(s | ((par ^ parity8(s)) << 7));
}

int ham_decode(uint8_t *blk)
{
	unsigned int par, s = data_syndrome(blk, &par) ^ (blk[HAM_K] & 0x7fU);
	unsigned int odd = par ^ parity8(blk[HAM_K]);

	if (s == 0) {
		/* Clean, or only the overall parity bit flipped. */
		return odd ? 1 : 0;
	}
	if (!odd) {
		return -1;
	}
	if (bit_at[s] != 0xff) {
		blk[bit_at[s] / 8] ^= (uint8_t)(1U << (bit_at[s] % 8));
	}
	return 1;
}
```

## src/hamming.h
```c
/*
 * SPDX-License-Identifier: GPL-3.0-or-later
 *
 * Extended Hamming (128,120): 15 data bytes and one parity byte per block;
 * corrects one bit error and detects two. Portable C.
 */

#ifndef LINK_HAMMING_H_
#define LINK_HAMMING_H_

#include <stdint.h>

#define HAM_N 16
#define HAM_K 15

/* Build the syndrome tables; call once before the others. */
void ham_init(void);

/* Set blk[HAM_K] from blk[0..HAM_K). */
void ham_encode(uint8_t *blk);

/* Correct blk in place: 0 clean, 1 one bit corrected, -1 two or more errors. */
int ham_decode(uint8_t *blk);

#endif /* LINK_HAMMING_H_ */
```

## src/mac.h
```c
/*
 * SPDX-License-Identifier: GPL-3.0-or-later
 *
 * CSMA/CA MAC over the QAM PHY: carrier sense on short captures, DIFS and
 * binary exponential backoff counted in sense slots, stop and wait ARQ with
 * immediate ACKs, duplicate detection by sequence number. One thread owns
 * the radio; frames play from a DAC bank in a loop for a fixed airtime so
 * that a listening receiver catches one whole copy.
 */

#ifndef LINK_MAC_H_
#define LINK_MAC_H_

#include <stdbool.h>
#include <stdint.h>

#include <zephyr/kernel.h>

#include <esp_sdr/esp_sdr.h>

#include "qam.h"

#define MAC_ADDR_BROADCAST 0xffU

enum mac_type {
	MAC_DATA,
	MAC_ACK,
};

/* PHY of the frames (with OFDM the ACKs are header-only OFDM frames). */
enum mac_phy {
	MAC_PHY_QAM,
	MAC_PHY_OFDM,
};

struct mac_cfg {
	uint32_t freq_mhz;
	/* enum mac_phy; both ends alike, and for OFDM the same "ofdm set" settings. */
	int phy;
	/* Transmit power step, receive gain index (ESP_SDR_RX_GAIN_AUTO for AGC). */
	int tx_gain;
	int rx_gain;
	/* TX low-pass codes (esp_sdr_tx_set_lpf(), -1 the PHY's). */
	int tx_lpf_a, tx_lpf_b;
	/* PHY channel bandwidth flag (esp_sdr_set_channel_bw()). */
	int cbw;
	/* Receive filter: two-sided MHz, 0 widest, -1 the PHY's own setting. */
	int bw_mhz;
	/* Receiver: average up to this many loop copies of short frames. */
	int avg;
	/* RMS DAC amplitude of a frame. */
	int amp;
	/* Time a data frame and an ACK stay on air, in us. */
	uint32_t data_air_us;
	uint32_t ack_air_us;
	/* How long a sender listens for the ACK after its frame, in us. */
	uint32_t ack_timeout_us;
	/* Front end settling at each TX/RX switch, and whether it retunes the LO. */
	uint32_t turn_us;
	bool turn_retune;
	/* Carrier sense threshold above the measured noise floor, in dB. */
	int cca_db;
	/* Quiet sense slots before the backoff counts, contention window limits, retries. */
	uint8_t difs;
	uint16_t cw_min;
	uint16_t cw_max;
	uint8_t retries;
	uint8_t addr;
};

/* Counters since boot; the reporter diffs snapshots. */
struct mac_stats {
	/* Sender: new frames, transmissions (with retries), ACKed, given up. */
	uint32_t tx_frames;
	uint32_t tx_attempts;
	uint32_t tx_acked;
	uint32_t tx_dropped;
	uint64_t tx_bytes_acked;
	/* Sense slots found busy, backoff slots counted down. */
	uint32_t cca_busy;
	uint32_t backoff_slots;
	/* Receiver: energy triggers and what decoding them gave. */
	uint32_t rx_triggers;
	uint32_t rx_none;
	uint32_t rx_hdr_err;
	uint32_t rx_data_err;
	uint32_t rx_ok;
	uint32_t rx_dup;
	uint32_t rx_lost;
	uint32_t rx_other;
	uint64_t rx_bytes;
	/* Uptime of the last new data frame, in ms. */
	int64_t rx_last_ms;
	uint32_t acks_sent;
	uint32_t acks_rx;
	/* Sums for averages over decoded frames: MER (centi dB), corrected bytes. */
	int64_t mer_cdb_sum;
	int64_t cfo_hz_sum;
	uint32_t mer_n;
	uint32_t corrected;
	/* Timing in us: decode, front end to TX and back, sense slot. */
	uint64_t decode_us_sum;
	uint32_t decode_n;
	uint32_t decode_us_max;
	uint64_t tx_on_us_sum;
	uint64_t tx_off_us_sum;
	uint32_t tx_switches;
	uint64_t sense_us_sum;
	uint32_t sense_n;
	/* Pair decoding: first frame (this CPU), second (other CPU), both done. */
	uint64_t pair_a_us_sum, pair_b_us_sum, pair_us_sum;
	uint32_t pair_n;
	/* Frame builds (background and retries). */
	uint64_t build_us_sum;
	uint32_t build_n;
	/* Decoder stages (qam_rx_info.prof), summed in us. */
	uint64_t prof_us[6];
	/* Capture engine time of the last sense slot and full window, in us. */
	uint32_t sense_engine_us;
	uint32_t window_engine_us;
};

int link_mac_init(void);

/* Current configuration; link_mac_set_cfg() applies a changed copy while idle. */
void link_mac_get_cfg(struct mac_cfg *cfg);
int link_mac_set_cfg(const struct mac_cfg *cfg);

/* Noise floor in raw units squared (re-measured with link_mac_calibrate()). */
float link_mac_noise_floor(void);
int link_mac_calibrate(void);

/*
 * Send test frames (@p ncw units of @p fec, 0: full frames) to @p dst, @p window
 * of them per transmission (1, or 2 as a pair the receiver decodes on both
 * CPUs), until @p duration_ms passes (0: until stopped),
 * at most @p rate_kbps of user data (0: as fast as the MAC goes).
 */
int link_mac_client_start(uint8_t dst, enum qam_mod mod, enum qam_fec fec, unsigned int ncw,
			  unsigned int window, uint32_t duration_ms, uint32_t rate_kbps);
void link_mac_client_stop(void);
bool link_mac_client_active(void);
/* When the client last finished (its last frame done), in ms of uptime. */
int64_t link_mac_client_end_ms(void);

void link_mac_get_stats(struct mac_stats *st);
void link_mac_clear_stats(void);

/*
 * Build a frame at @p mod and decode it from memory (MAC paused), no radio:
 * the decoder's own time.
 */
int link_mac_bench_decode(enum qam_mod mod, struct qam_rx_info *info, uint32_t *build_us,
			  uint32_t *decode_us);

/* Park the MAC thread (radio idle) for measurements. */
void link_mac_pause(bool pause);

/*
 * Run @p fn(@p arg) on the paused MAC thread (link_mac_pause()) and wait for
 * it: the decoders need about 3.5 KB of stack, more than the shell has.
 *
 * @return 0; -ENODEV if the MAC thread does not run (the radio failed to
 * start); -ETIMEDOUT if it did not take the job within 10 s.
 */
int link_mac_run_paused(void (*fn)(void *arg), void *arg);

/*
 * Hand out the next capture that crossed the carrier sense threshold (with
 * @p decoded: that held a data frame that decoded) within @p timeout: the MAC thread then holds the bank until link_mac_dump_release().
 */
int link_mac_dump_take(const uint32_t **words, size_t *n, bool decoded, k_timeout_t timeout);
void link_mac_dump_release(void);

/* User bytes per data frame at @p mod with the current PHY settings, 0 if none fit. */
size_t link_mac_frame_bytes(enum qam_mod mod);

struct ofdm_ctx;

/* The OFDM context the MAC and the "ofdm" shell test share, set up (ofdm_test.c). */
struct ofdm_ctx *link_ofdm(void);

/* Its transmit and receive rates. */
enum esp_sdr_rate link_ofdm_tx_rate(void);
enum esp_sdr_rate link_ofdm_rx_rate(void);

#endif /* LINK_MAC_H_ */
```

## src/ofdm.h
```c
/*
 * SPDX-License-Identifier: GPL-3.0-or-later
 *
 * OFDM physical layer on raw radio words. Configured by occupied bandwidth,
 * subcarrier count and cyclic prefix; the FFT size follows (the power of two
 * that puts that many subcarriers into that bandwidth at the sample rate).
 * Complex baseband: the subcarriers sit on both sides of DC, DC unused. The
 * modulation (BPSK to 64-QAM) is chosen per frame.
 *
 * A frame is a Schmidl-Cox preamble (known BPSK on the even subcarriers, so
 * its time halves repeat), one or more pilot symbols (known BPSK on all, for
 * the channel estimate), optional header symbols (BPSK, the header bits
 * repeated over all their subcarriers) and the payload symbols, each with a
 * cyclic prefix. The frame is built to loop in the DAC like the QAM frames;
 * the receiver decodes one whole copy from a capture window at least twice
 * the frame long.
 *
 * Carrier offset correction covers +-1 subcarrier spacing.
 */

#ifndef ESDR_LINK_OFDM_H
#define ESDR_LINK_OFDM_H

#include <stdbool.h>
#include <stddef.h>
#include <stdint.h>

/* Receive and transmit words: esp_sdr_rx_i/q(), esp_sdr_tx_word(). */
#include <esp_sdr/esp_sdr.h>

#define OFDM_NFFT_MIN 16U
#define OFDM_NFFT_MAX 512U
/* Shortest cyclic prefix as a fraction of the FFT size (cp_div at most this). */
#define OFDM_CP_DIV_MAX 32U
/* Subcarriers in use at most: a quarter of the band stays free around Nyquist. */
#define OFDM_CH_MAX (OFDM_NFFT_MAX * 3U / 4U)
/* Power of two above the longest cyclic prefix (nfft / 4). */
#define OFDM_RING 256U
#define OFDM_PILOTS_MAX 4U
#define OFDM_HDR_BITS_MAX 64U

enum ofdm_mod {
	OFDM_BPSK,
	OFDM_QPSK,
	OFDM_16QAM,
	OFDM_64QAM,
	OFDM_MODS
};

struct ofdm_cfg {
	/* Radio sample rate, Hz. */
	uint32_t sample_rate_hz;
	/* Occupied bandwidth, Hz: rounded so that spacing = sample_rate / nfft. */
	uint32_t bandwidth_hz;
	/* Subcarriers in use (pilot and data), DC excluded. */
	unsigned int channels;
	/* Cyclic prefix: nfft / cp_div samples (4 to OFDM_CP_DIV_MAX). */
	unsigned int cp_div;
	/* Transmit RMS amplitude, DAC units (full scale 511). */
	int amp;
	/* Symbols after the pilots (header and payload), 0: as many as fit max_samples. */
	unsigned int symbols;
	/* Longest frame in samples. */
	size_t max_samples;
	/* The receiver samples at sample_rate_hz / rx_div (1 or 2): half the work at 2. */
	unsigned int rx_div;
	/* Pilot symbols (1 to OFDM_PILOTS_MAX), averaged for the channel estimate. */
	unsigned int pilots;
	/* Also smooth the estimate over neighbouring subcarriers (3 taps). */
	bool smooth;
	/* Header bits per frame (0 to OFDM_HDR_BITS_MAX), on BPSK symbols before the payload. */
	unsigned int hdr_bits;
	/*
	 * Another pilot symbol in the middle of the payload: the phase is
	 * measured again there, so the second half can be decoded on its own
	 * (on another CPU) and a long frame does not drift.
	 */
	bool mid_pilot;
};

struct ofdm_cf {
	float re, im;
};

/*
 * One receiver working through symbols: its FFT buffer, the tracked common
 * phase and its rate per slot (a residual carrier offset), and the known
 * phase of its current window (u). Two of them decode one frame on two CPUs.
 */
struct ofdm_worker {
	struct ofdm_cf buf[OFDM_NFFT_MAX] __attribute__((aligned(16)));
	struct ofdm_cf trk, rate, u;
};

/* Receive state between ofdm_rx_begin() and ofdm_rx_finish(). */
struct ofdm_rxstate {
	int start, dci, dcq;
	float eps;
	/* Step of the window phase per slot. */
	struct ofdm_cf us;
	/* How early the FFT window starts, from the pilots' phase slope (samples). */
	float delay;
	/* First payload slot. */
	unsigned int slot;
	float soft[OFDM_HDR_BITS_MAX];
};

struct ofdm_ctx {
	/* FFT twiddles (esp-dsp radix-2 layout: cos, sin, bit reversed; serves every size up
	 * to nfft).
	 */
	float w[OFDM_NFFT_MAX] __attribute__((aligned(16)));
	/* The receiver's own worker (search, channel, header, payload). */
	struct ofdm_worker w0;
	struct ofdm_cfg cfg;
	/* Derived by ofdm_init(): transmit layout at sample_rate_hz; the payload symbol the
	 * mid pilot comes before (ndata if none).
	 */
	unsigned int nfft, log2n, cp, nhdr, ndata, mid;
	size_t slot, len;
	float spacing_hz, bw_hz;
	/* The same frame at the receive rate. */
	unsigned int rnfft, rcp;
	size_t rslot, rlen;
	/* Bit reversal over nfft; per subcarrier (frequency order) its transmit FFT bin and
	 * where it comes out of the (bit reversed) receive FFT.
	 */
	uint16_t rev[OFDM_NFFT_MAX];
	uint16_t bin[OFDM_CH_MAX], binr[OFDM_CH_MAX];
	/* Equalizer per subcarrier, conj(H) / |H|^2, from the last pilots. */
	struct ofdm_cf eq[OFDM_CH_MAX];
	union {
		/* Search: the last preamble metrics (numerator, denominator) over the prefix. */
		struct {
			float rnum[OFDM_RING], rden[OFDM_RING];
		};
		/* Then the carrier offset derotation over one receive FFT window. */
		struct ofdm_cf rot[OFDM_NFFT_MAX];
	};
	struct ofdm_rxstate rx;
};

/* A transmit work buffer (ofdm_tx_build()), separate so that building and decoding can overlap. */
struct ofdm_txbuf {
	struct ofdm_cf buf[OFDM_NFFT_MAX] __attribute__((aligned(16)));
	/* Samples clipped by the last build. */
	uint32_t clipped;
};

/*
 * Derive the frame layout from @p cfg.
 *
 * @retval 0 on success.
 * @retval -1 if no FFT size fits (bandwidth, channel count, cp_div, frame length).
 */
int ofdm_init(struct ofdm_ctx *ctx, const struct ofdm_cfg *cfg);

static inline unsigned int ofdm_mod_bits(enum ofdm_mod mod)
{
	static const uint8_t bits[OFDM_MODS] = {1, 2, 4, 6};

	return mod < OFDM_MODS ? bits[mod] : 0U;
}

/* Payload bits per frame at @p mod. */
static inline size_t ofdm_frame_bits(const struct ofdm_ctx *ctx, enum ofdm_mod mod)
{
	return (size_t)ctx->ndata * ctx->cfg.channels * ofdm_mod_bits(mod);
}

/* Length of a header-only frame (preamble, pilots, header), at the transmit and receive rate. */
static inline size_t ofdm_hdr_samples(const struct ofdm_ctx *ctx)
{
	return (size_t)(1U + ctx->cfg.pilots + ctx->nhdr) * ctx->slot;
}

static inline size_t ofdm_hdr_rsamples(const struct ofdm_ctx *ctx)
{
	return (size_t)(1U + ctx->cfg.pilots + ctx->nhdr) * ctx->rslot;
}

/* Test payload: whitened bits, a function of @p seed (packed, MSB first). */
void ofdm_test_bits(uint8_t *bits, size_t nbits, uint32_t seed);

/*
 * Build one frame into @p out (ctx->len words): cfg.hdr_bits header bits from
 * @p hdr, ofdm_frame_bits(mod) payload bits from @p bits (packed, MSB first).
 * With @p bits NULL a header-only frame (ofdm_hdr_samples() words). Only
 * reads @p ctx.
 *
 * @return Its length in samples, 0 for a bad modulation.
 */
size_t ofdm_tx_build(const struct ofdm_ctx *ctx, struct ofdm_txbuf *tb, enum ofdm_mod mod,
		     const uint8_t *hdr, const uint8_t *bits, uint32_t *out);

struct ofdm_rx_info {
	/* Frame start in the window, sample index. */
	int start;
	/* Preamble metric of that start (normalized correlation, squared). */
	float metric;
	/* Carrier offset: in subcarrier spacings, and in Hz. */
	float cfo_frac, cfo_hz;
	/* Error of the payload symbols against their decisions, dB. */
	float mer_db;
	/* Cycles (ofdm_clock): search, channel estimate and header, payload. */
	uint32_t prof[3];
};

/* Optional cycle counter for ofdm_rx_info.prof. */
extern uint32_t (*ofdm_clock)(void);

/*
 * Find a whole frame copy in @p n receive words (at the receive rate), set up
 * the channel and decode the header into @p hdr (cfg.hdr_bits bits). The window
 * must hold one whole copy (a looped frame: n >= 2 * ctx->rlen + ctx->rcp).
 *
 * @retval 0 on success.
 * @retval -1 if no preamble was found.
 */
int ofdm_rx_begin(struct ofdm_ctx *ctx, const uint32_t *words, size_t n, uint8_t *hdr,
		  struct ofdm_rx_info *info);

/* The same for a frame looping with @p period receive samples (header-only: ofdm_hdr_rsamples()). */
int ofdm_rx_begin_period(struct ofdm_ctx *ctx, const uint32_t *words, size_t n, size_t period,
			 uint8_t *hdr, struct ofdm_rx_info *info);

/* Then the ofdm_frame_bits(mod) payload bits into @p bits, from the same words. */
void ofdm_rx_finish(struct ofdm_ctx *ctx, const uint32_t *words, enum ofdm_mod mod, uint8_t *bits,
		    struct ofdm_rx_info *info);

/*
 * The payload in two parts, e.g. on two CPUs: ctx->w0 decodes payload
 * symbols 0 .. mid - 1, a second worker set up by ofdm_rx_fork() (which
 * measures the phase on the mid pilot) symbols mid .. ndata - 1.
 * ofdm_rx_part() decodes s0 .. s1 - 1 into @p bits (the frame's bits from
 * symbol s0 on; mid starts a byte) and adds their squared error to @p err.
 * Only the workers are written.
 */
void ofdm_rx_fork(const struct ofdm_ctx *ctx, struct ofdm_worker *wk, const uint32_t *words);
void ofdm_rx_part(const struct ofdm_ctx *ctx, struct ofdm_worker *wk, const uint32_t *words,
		  enum ofdm_mod mod, unsigned int s0, unsigned int s1, uint8_t *bits, float *err);

/* MER of a payload from its squared error. */
float ofdm_rx_mer(const struct ofdm_ctx *ctx, float err);

/* Forward FFT of the receive buffer in place (output bit reversed, see ctx->rev); for tests. */
void ofdm_test_fft(struct ofdm_ctx *ctx);

#endif
```

## src/ofdm_frame.c
```c
/*
 * SPDX-License-Identifier: GPL-3.0-or-later
 *
 * Link frames on the OFDM PHY, see ofdm_frame.h. The payload capacity (whole
 * bytes of the payload symbols) is split into the fewest RS units of at most
 * 255 bytes, all the same length: shortened codes, the missing data bytes
 * virtual zeros in front. Frame byte j belongs to unit j % units.
 */

#include <string.h>

#include "ofdm_frame.h"
#include "qam.h"
#include "rs.h"

#define HDR_VERSION 0xa5U

struct layout {
	unsigned int units, len, k;
	size_t cap, user;
};

static bool layout_of(const struct ofdm_ctx *ctx, enum ofdm_mod mod, struct layout *l)
{
	if (mod >= OFDM_MODS) {
		return false;
	}
	l->cap = ofdm_frame_bits(ctx, mod) / 8U;
	/* The work buffer holds the payload bits rounded up to bytes. */
	if (l->cap >= OFDM_FRAME_CAP_MAX) {
		return false;
	}
	l->units = (unsigned int)((l->cap + RS_N - 1U) / RS_N);
	if (l->units == 0U) {
		return false;
	}
	l->len = (unsigned int)(l->cap / l->units);
	/* A unit needs its parity and some data; the user data its CRC. */
	if (l->len < RS_NROOTS + 8U) {
		return false;
	}
	l->k = l->len - RS_NROOTS;
	l->user = (size_t)l->units * l->k - 4U;
	return true;
}

size_t ofdm_frame_user_bytes(const struct ofdm_ctx *ctx, enum ofdm_mod mod)
{
	struct layout l;

	return layout_of(ctx, mod, &l) ? l.user : 0U;
}

static void hdr_pack(const struct ofdm_fhdr *h, uint8_t b[8])
{
	uint16_t crc;

	b[0] = (uint8_t)(((h->type & 1U) << 7) | ((unsigned int)h->mod << 4));
	b[1] = h->dst;
	b[2] = h->src;
	b[3] = (uint8_t)h->seq;
	b[4] = (uint8_t)(h->seq >> 8);
	b[5] = HDR_VERSION;
	crc = qam_crc16(b, 6);
	b[6] = (uint8_t)crc;
	b[7] = (uint8_t)(crc >> 8);
}

static bool hdr_unpack(const uint8_t b[8], struct ofdm_fhdr *h)
{
	if (b[5] != HDR_VERSION || qam_crc16(b, 6) != (uint16_t)(b[6] | (b[7] << 8)) ||
	    (b[0] & 0x0fU) != 0U || ((b[0] >> 4) & 7U) >= OFDM_MODS) {
		return false;
	}
	h->type = b[0] >> 7;
	h->mod = (enum ofdm_mod)((b[0] >> 4) & 7U);
	h->dst = b[1];
	h->src = b[2];
	h->seq = (uint16_t)(b[3] | (b[4] << 8));
	return true;
}

/* Unit u's byte p as sent (data, then parity), inside its 255 byte buffer. */
static inline uint8_t *unit_byte(struct ofdm_fwork *wk, const struct layout *l, unsigned int u,
				 unsigned int p)
{
	return &wk->units[u][RS_N - l->len + p];
}

size_t ofdm_frame_build(const struct ofdm_ctx *ctx, struct ofdm_txbuf *tb, struct ofdm_fwork *wk,
			const struct ofdm_fhdr *h, const uint8_t *data, uint32_t *out)
{
	struct layout l;
	uint8_t hb[8];
	uint32_t crc;
	size_t j;

	if (!layout_of(ctx, h->mod, &l)) {
		return 0;
	}
	crc = qam_crc32(data, l.user);
	/* User data, then its CRC (little endian), over the units' data bytes. */
	for (unsigned int u = 0; u < l.units; u++) {
		memset(wk->units[u], 0, RS_N);
	}
	for (size_t d = 0; d < l.user + 4U; d++) {
		uint8_t v = d < l.user ? data[d] : (uint8_t)(crc >> (8U * (d - l.user)));

		*unit_byte(wk, &l, (unsigned int)(d / l.k), (unsigned int)(d % l.k)) = v;
	}
	for (unsigned int u = 0; u < l.units; u++) {
		rs_encode(wk->units[u]);
	}
	for (j = 0; j < (size_t)l.units * l.len; j++) {
		wk->bytes[j] = *unit_byte(wk, &l, (unsigned int)(j % l.units),
					  (unsigned int)(j / l.units));
	}
	memset(&wk->bytes[j], 0, l.cap - j + 1U);
	hdr_pack(h, hb);
	return ofdm_tx_build(ctx, tb, h->mod, hb, wk->bytes, out);
}

size_t ofdm_frame_build_hdr(const struct ofdm_ctx *ctx, struct ofdm_txbuf *tb,
			    const struct ofdm_fhdr *h, uint32_t *out)
{
	uint8_t hb[8];

	hdr_pack(h, hb);
	return ofdm_tx_build(ctx, tb, OFDM_BPSK, hb, NULL, out);
}

int ofdm_frame_begin_hdr(struct ofdm_ctx *ctx, const uint32_t *words, size_t n,
			 struct ofdm_fhdr *h, struct ofdm_rx_info *info)
{
	uint8_t hb[8];

	if (ofdm_rx_begin_period(ctx, words, n, ofdm_hdr_rsamples(ctx), hb, info) != 0) {
		return -1;
	}
	return hdr_unpack(hb, h) ? 0 : -2;
}

int ofdm_frame_begin(struct ofdm_ctx *ctx, const uint32_t *words, size_t n, struct ofdm_fhdr *h,
		     struct ofdm_rx_info *info)
{
	uint8_t hb[8];

	if (ofdm_rx_begin(ctx, words, n, hb, info) != 0) {
		return -1;
	}
	return hdr_unpack(hb, h) ? 0 : -2;
}

int ofdm_frame_finish(struct ofdm_ctx *ctx, const uint32_t *words, const struct ofdm_fhdr *h,
		      struct ofdm_fwork *wk, uint8_t *data, int *corrected,
		      struct ofdm_rx_info *info)
{
	struct layout l;

	if (!layout_of(ctx, h->mod, &l)) {
		*corrected = 0;
		return -3;
	}
	ofdm_rx_finish(ctx, words, h->mod, wk->bytes, info);
	return ofdm_frame_fec(ctx, h, wk, data, corrected);
}

int ofdm_frame_fec_units(const struct ofdm_ctx *ctx, const struct ofdm_fhdr *h,
			 struct ofdm_fwork *wk, unsigned int u0, unsigned int u1, int *corrected)
{
	struct layout l;

	*corrected = 0;
	if (!layout_of(ctx, h->mod, &l)) {
		return -3;
	}
	u1 = u1 > l.units ? l.units : u1;
	for (unsigned int u = u0; u < u1; u++) {
		/* Decoded on the stack: the work memory may be PSRAM. */
		uint8_t cw[RS_N];
		int r;

		memset(cw, 0, RS_N - l.len);
		for (unsigned int p = 0; p < l.len; p++) {
			cw[RS_N - l.len + p] = wk->bytes[(size_t)p * l.units + u];
		}
		r = rs_decode(cw);
		if (r < 0) {
			return -3;
		}
		/* A miscorrection may land in the virtual zeros. */
		for (unsigned int i = 0; i < RS_N - l.len; i++) {
			if (cw[i] != 0U) {
				return -3;
			}
		}
		memcpy(wk->units[u], cw, RS_N);
		*corrected += r;
	}
	return 0;
}

unsigned int ofdm_frame_units(const struct ofdm_ctx *ctx, enum ofdm_mod mod)
{
	struct layout l;

	return layout_of(ctx, mod, &l) ? l.units : 0U;
}

int ofdm_frame_check(const struct ofdm_ctx *ctx, const struct ofdm_fhdr *h, struct ofdm_fwork *wk,
		     uint8_t *data)
{
	struct layout l;
	uint32_t crc = 0;

	if (!layout_of(ctx, h->mod, &l)) {
		return -3;
	}
	for (size_t d = 0; d < l.user + 4U; d++) {
		uint8_t v = *unit_byte(wk, &l, (unsigned int)(d / l.k), (unsigned int)(d % l.k));

		if (d < l.user) {
			data[d] = v;
		} else {
			crc |= (uint32_t)v << (8U * (d - l.user));
		}
	}
	return qam_crc32(data, l.user) == crc ? 0 : -3;
}

int ofdm_frame_fec(const struct ofdm_ctx *ctx, const struct ofdm_fhdr *h, struct ofdm_fwork *wk,
		   uint8_t *data, int *corrected)
{
	int ret = ofdm_frame_fec_units(ctx, h, wk, 0, ~0U, corrected);

	return ret != 0 ? ret : ofdm_frame_check(ctx, h, wk, data);
}
```

## src/ofdm_frame.h
```c
/*
 * SPDX-License-Identifier: GPL-3.0-or-later
 *
 * Link frames on the OFDM PHY: a 64 bit header (type, modulation, addresses,
 * sequence number, CRC-16) on the BPSK header symbols, and a payload of
 * shortened RS(255,223) units, byte interleaved over the frame (a weak
 * subcarrier spreads its errors over all units), carrying the user data and
 * its CRC-32.
 */

#ifndef ESDR_LINK_OFDM_FRAME_H
#define ESDR_LINK_OFDM_FRAME_H

#include <stddef.h>
#include <stdint.h>

#include "ofdm.h"

#define OFDM_FRAME_HDR_BITS 64U
/* Payload bytes per frame at most (four bits per sample over a 16 k sample bank). */
#define OFDM_FRAME_CAP_MAX 8192U
#define OFDM_FRAME_UNITS_MAX ((OFDM_FRAME_CAP_MAX + 254U) / 255U)

struct ofdm_fhdr {
	uint8_t type;
	enum ofdm_mod mod;
	uint8_t dst, src;
	uint16_t seq;
};

/* Work memory for one build or decode (may be in PSRAM). */
struct ofdm_fwork {
	uint8_t bytes[OFDM_FRAME_CAP_MAX + 1U];
	uint8_t units[OFDM_FRAME_UNITS_MAX][255];
};

/* User data bytes per frame at @p mod, 0 if the frame is too short to code. */
size_t ofdm_frame_user_bytes(const struct ofdm_ctx *ctx, enum ofdm_mod mod);

/*
 * Build a frame of ofdm_frame_user_bytes(h->mod) bytes from @p data into
 * @p out (ctx->len words). Only reads @p ctx.
 *
 * @return ctx->len, 0 for a bad modulation or a frame too short to code.
 */
size_t ofdm_frame_build(const struct ofdm_ctx *ctx, struct ofdm_txbuf *tb, struct ofdm_fwork *wk,
			const struct ofdm_fhdr *h, const uint8_t *data, uint32_t *out);

/*
 * A header-only frame (an ACK; ofdm_hdr_samples() long) from @p h, and its
 * reception (a window of at least 2 ofdm_hdr_rsamples() + rcp words).
 */
size_t ofdm_frame_build_hdr(const struct ofdm_ctx *ctx, struct ofdm_txbuf *tb,
			    const struct ofdm_fhdr *h, uint32_t *out);
int ofdm_frame_begin_hdr(struct ofdm_ctx *ctx, const uint32_t *words, size_t n,
			 struct ofdm_fhdr *h, struct ofdm_rx_info *info);

/*
 * Find a frame in @p n receive words and read its header.
 *
 * @retval 0 on success; the payload follows with ofdm_frame_finish().
 * @retval -1 if no preamble was found.
 * @retval -2 for a header with a bad CRC.
 */
int ofdm_frame_begin(struct ofdm_ctx *ctx, const uint32_t *words, size_t n, struct ofdm_fhdr *h,
		     struct ofdm_rx_info *info);

/*
 * Decode the payload of the frame ofdm_frame_begin() found: @p data gets
 * ofdm_frame_user_bytes(h->mod) bytes, @p corrected the byte errors RS fixed.
 *
 * @retval 0 on success.
 * @retval -3 if an RS unit failed or the CRC-32 does not match.
 */
int ofdm_frame_finish(struct ofdm_ctx *ctx, const uint32_t *words, const struct ofdm_fhdr *h,
		      struct ofdm_fwork *wk, uint8_t *data, int *corrected,
		      struct ofdm_rx_info *info);

/*
 * The FEC half of ofdm_frame_finish(), for a caller that demodulated the
 * payload itself (e.g. on two CPUs with ofdm_rx_part()) into wk->bytes.
 */
int ofdm_frame_fec(const struct ofdm_ctx *ctx, const struct ofdm_fhdr *h, struct ofdm_fwork *wk,
		   uint8_t *data, int *corrected);

/*
 * The same in parts, e.g. on two CPUs: RS units u0 .. u1 - 1 (of
 * ofdm_frame_units()) de-interleaved from wk->bytes and decoded, then the
 * user data and its CRC once all units are done.
 */
unsigned int ofdm_frame_units(const struct ofdm_ctx *ctx, enum ofdm_mod mod);
int ofdm_frame_fec_units(const struct ofdm_ctx *ctx, const struct ofdm_fhdr *h,
			 struct ofdm_fwork *wk, unsigned int u0, unsigned int u1, int *corrected);
int ofdm_frame_check(const struct ofdm_ctx *ctx, const struct ofdm_fhdr *h, struct ofdm_fwork *wk,
		     uint8_t *data);

#endif
```

## src/ofdm_test.c
```c
/*
 * SPDX-License-Identifier: GPL-3.0-or-later
 *
 * Raw OFDM test on the radio, outside the MAC (paused meanwhile): one board
 * loops a frame of known test bits on the DAC, the other decodes captures of
 * it and counts bit errors. Both must be set alike ("ofdm set").
 */

#include <math.h>
#include <stdio.h>
#include <stdlib.h>
#include <string.h>

#include <zephyr/kernel.h>
#include <zephyr/shell/shell.h>
#include <zephyr/sys/util.h>

#include <esp_sdr/esp_sdr.h>

#include <esp_attr.h>

#include "mac.h"
#include "ofdm.h"
#include "rs.h"

/* Transmit at the layout's sample rate, receive at that divided by rx_div. */
#define TX_RATE   (cfg.sample_rate_hz == 40000000U ? ESP_SDR_RATE_40MSPS : ESP_SDR_RATE_80MSPS)
#define RX_RATE   (cfg.sample_rate_hz / cfg.rx_div == 40000000U ? ESP_SDR_RATE_40MSPS \
							       : ESP_SDR_RATE_80MSPS)
#define WINDOW    ESP_SDR_SAMPLES_MAX
#define TX_BANK   1
#define BITS_SEED 1U
#define BITS_MAX  (WINDOW / 2U)
#define HDR_BITS  64U

/* FFT tables and buffers above the capture bank: internal SRAM, outside the libc heap. */
static ESP_SDR_HIGH_RAM struct ofdm_ctx ctx __aligned(16);
/* Transmit builds are not timed: PSRAM will do. */
static EXT_RAM_BSS_ATTR struct ofdm_txbuf txb __aligned(16);
static EXT_RAM_BSS_ATTR uint8_t ref_bits[BITS_MAX], rx_bits[BITS_MAX];
static uint8_t ref_hdr[HDR_BITS / 8U], rx_hdr[HDR_BITS / 8U];
static enum ofdm_mod mod = OFDM_QPSK;

static struct ofdm_cfg cfg = {
	.sample_rate_hz = CONFIG_APP_OFDM_FS_MHZ * 1000000U,
	.bandwidth_hz = CONFIG_APP_OFDM_BW_KHZ * 1000U,
	.channels = CONFIG_APP_OFDM_CHANNELS,
	.cp_div = 8,
	.amp = 90,
	.symbols = 0,
	/* Set by layout_limit(): a whole copy must fit the receive window. */
	.max_samples = 0,
	.rx_div = CONFIG_APP_OFDM_RX_DIV,
	.pilots = 2,
	.smooth = true,
	.hdr_bits = HDR_BITS,
	.mid_pilot = true,
};
static bool ready;

static const char *const mod_names[OFDM_MODS] = {"bpsk", "qpsk", "16qam", "64qam"};

static uint32_t cyc(void)
{
	return k_cycle_get_32();
}

/*
 * Longest frame (transmit samples): the DAC bank, and two copies plus a prefix
 * in the receive window. At half the receive rate that is the whole bank.
 */
static void layout_limit(struct ofdm_cfg *c)
{
	c->max_samples = c->rx_div == 2U ? WINDOW - 2U * OFDM_NFFT_MAX / 4U : (WINDOW + 1U) / 2U;
}

/* 80 or 40 MS/s; the receiver below 40 MS/s has no rate. */
static bool rates_ok(const struct ofdm_cfg *c)
{
	return (c->sample_rate_hz == 80000000U || c->sample_rate_hz == 40000000U) &&
	       c->sample_rate_hz / c->rx_div >= 40000000U;
}

enum esp_sdr_rate link_ofdm_tx_rate(void)
{
	return TX_RATE;
}

enum esp_sdr_rate link_ofdm_rx_rate(void)
{
	return RX_RATE;
}

static int prepare(const struct shell *sh)
{
	if (!ready) {
		layout_limit(&cfg);
		if (ofdm_init(&ctx, &cfg) != 0) {
			if (sh != NULL) {
				shell_error(sh, "no frame layout for these settings");
			}
			return -EINVAL;
		}
		if (ofdm_frame_bits(&ctx, OFDM_64QAM) > BITS_MAX * 8U) {
			if (sh != NULL) {
				shell_error(sh, "frame too long");
			}
			return -EINVAL;
		}
		/* A prefix of the same sequence for every modulation. */
		ofdm_test_bits(ref_bits, BITS_MAX * 8U, BITS_SEED);
		ofdm_test_bits(ref_hdr, HDR_BITS, BITS_SEED + 1U);
		ofdm_clock = cyc;
		ready = true;
	}
	return 0;
}

static void show(const struct shell *sh)
{
	size_t bits = ofdm_frame_bits(&ctx, mod);
	float us = (float)ctx.len * 1e6f / (float)cfg.sample_rate_hz;

	shell_print(sh, "%s, %u subcarriers, %.3f MHz (asked %.3f), spacing %.1f kHz, fft %u, "
		    "cp %u, %u pilots%s, %u header + %u data symbols", mod_names[mod],
		    cfg.channels, (double)(ctx.bw_hz / 1e6f), (double)(cfg.bandwidth_hz / 1e6f),
		    (double)(ctx.spacing_hz / 1e3f), ctx.nfft, ctx.cp, cfg.pilots,
		    cfg.smooth ? " smoothed" : "", ctx.nhdr, ctx.ndata);
	shell_print(sh, "frame %u samples at %u MS/s (%.1f us), %u bits: %.2f Mbit/s on air, "
		    "tx rms %d, rx at %u MS/s (fft %u)%s",
		    (unsigned int)ctx.len, cfg.sample_rate_hz / 1000000U, (double)us,
		    (unsigned int)bits, (double)(bits / us),
		    cfg.amp, cfg.sample_rate_hz / cfg.rx_div / 1000000U, ctx.rnfft,
		    IS_ENABLED(CONFIG_APP_OFDM_ESP_DSP) ? ", esp-dsp fft" : ", C fft");
}

struct ofdm_ctx *link_ofdm(void)
{
	(void)prepare(NULL);
	return &ctx;
}

static int cmd_status(const struct shell *sh, size_t argc, char **argv)
{
	ARG_UNUSED(argc);
	ARG_UNUSED(argv);
	if (prepare(sh) != 0) {
		return -EINVAL;
	}
	show(sh);
	return 0;
}

/* One key into @p c (or @p m); false if unknown. */
static bool set_key(struct ofdm_cfg *c, enum ofdm_mod *m, const char *k, const char *v)
{
	if (strcmp(k, "bw") == 0) {
		c->bandwidth_hz = (uint32_t)(strtof(v, NULL) * 1e6f);
	} else if (strcmp(k, "ch") == 0) {
		c->channels = (unsigned int)strtoul(v, NULL, 0);
	} else if (strcmp(k, "cp") == 0) {
		c->cp_div = (unsigned int)strtoul(v, NULL, 0);
	} else if (strcmp(k, "amp") == 0) {
		c->amp = (int)strtol(v, NULL, 0);
	} else if (strcmp(k, "fs") == 0) {
		c->sample_rate_hz = (uint32_t)strtoul(v, NULL, 0) * 1000000U;
	} else if (strcmp(k, "rxdiv") == 0) {
		c->rx_div = (unsigned int)strtoul(v, NULL, 0);
	} else if (strcmp(k, "syms") == 0) {
		c->symbols = (unsigned int)strtoul(v, NULL, 0);
	} else if (strcmp(k, "pilots") == 0) {
		c->pilots = (unsigned int)strtoul(v, NULL, 0);
	} else if (strcmp(k, "smooth") == 0) {
		c->smooth = strtoul(v, NULL, 0) != 0U;
	} else if (strcmp(k, "mod") == 0) {
		*m = OFDM_MODS;
		for (int i = 0; i < OFDM_MODS; i++) {
			if (strcmp(v, mod_names[i]) == 0) {
				*m = (enum ofdm_mod)i;
			}
		}
	} else {
		return false;
	}
	return true;
}

/* Several pairs at once: the layout is checked on the whole combination. */
static int cmd_set(const struct shell *sh, size_t argc, char **argv)
{
	struct ofdm_cfg c = cfg;
	enum ofdm_mod m = mod;

	for (size_t i = 1; i + 1 < argc; i += 2) {
		if (!set_key(&c, &m, argv[i], argv[i + 1])) {
			argc = 0;
			break;
		}
	}
	if (argc % 2U == 0U) {
		shell_error(sh, "<key> <value> ...; keys: bw <MHz> ch <n> cp <fft/cp> "
			    "mod bpsk|qpsk|16qam|64qam amp <rms> syms <n, 0: fill> "
			    "rxdiv 1|2 fs 80|40 pilots 1..4 smooth 0|1");
		return -EINVAL;
	}
	layout_limit(&c);
	/* The MAC builds and decodes with this context: hold it off meanwhile. */
	link_mac_pause(true);
	if (m >= OFDM_MODS || !rates_ok(&c) || ofdm_init(&ctx, &c) != 0 || c.amp < 1 ||
	    c.amp > 400) {
		ready = false;
		(void)prepare(sh);
		link_mac_pause(false);
		shell_error(sh, "no frame layout for that, unchanged");
		return -EINVAL;
	}
	cfg = c;
	mod = m;
	ready = false;
	(void)prepare(sh);
	link_mac_pause(false);
	show(sh);
	return 0;
}

static int cmd_tx(const struct shell *sh, size_t argc, char **argv)
{
	uint32_t ms = 10000, t0;
	size_t words;
	uint32_t *bank;
	int ret;

	for (size_t i = 1; i + 1 < argc; i += 2) {
		if (strcmp(argv[i], "-t") == 0) {
			ms = (uint32_t)(strtof(argv[i + 1], NULL) * 1000.0f);
		}
	}
	if (prepare(sh) != 0) {
		return -EINVAL;
	}
	link_mac_pause(true);
	bank = esp_sdr_tx_loop_buf(TX_BANK, &words);
	t0 = cyc();
	(void)ofdm_tx_build(&ctx, &txb, mod, ref_hdr, ref_bits, bank);
	t0 = k_cyc_to_us_floor32(cyc() - t0);
	ret = esp_sdr_tx_loop_begin(TX_RATE);
	if (ret == 0) {
		ret = esp_sdr_tx_loop_start(TX_BANK, ctx.len);
		if (ret == 0) {
			shell_print(sh, "looping %u samples for %u ms (built in %u us, %u clipped)",
				    (unsigned int)ctx.len, ms, t0, txb.clipped);
			k_msleep(ms);
		}
		esp_sdr_tx_loop_end();
	}
	link_mac_pause(false);
	if (ret != 0) {
		shell_error(sh, "transmit failed (%d)", ret);
	}
	return ret;
}

/* Channel magnitude per subcarrier in dB against the mean, from the last pilot. */
static void print_channel(const struct shell *sh)
{
	float mean = 0.0f;
	char line[100];
	int len = 0;

	for (unsigned int a = 0; a < cfg.channels; a++) {
		struct ofdm_cf e = ctx.eq[a];

		mean += e.re * e.re + e.im * e.im;
	}
	mean /= (float)cfg.channels;
	shell_print(sh, "channel |H| dB vs mean, subcarriers from lowest frequency:");
	for (unsigned int a = 0; a < cfg.channels; a++) {
		struct ofdm_cf e = ctx.eq[a];
		float g = e.re * e.re + e.im * e.im;
		int db = g > 0.0f ? (int)lrintf(10.0f * log10f(mean / g)) : -99;

		len += snprintf(&line[len], sizeof(line) - len, "%4d", db);
		if (len > (int)sizeof(line) - 6 || a + 1 == cfg.channels) {
			shell_print(sh, "%s", line);
			len = 0;
		}
	}
}

static int cmd_rx(const struct shell *sh, size_t argc, char **argv)
{
	uint32_t n = 100, found = 0, bad = 0, hbad = 0;
	uint64_t errs = 0, prof[3] = {0}, cap_us = 0;
	float mer = 0.0f, cfo = 0.0f, mer_min = 99.0f;
	bool verbose = false, full = false, dump = false;
	size_t bits;

	for (size_t i = 1; i < argc; i++) {
		if (strcmp(argv[i], "-n") == 0 && i + 1 < argc) {
			n = (uint32_t)strtoul(argv[++i], NULL, 0);
		} else if (strcmp(argv[i], "-v") == 0) {
			verbose = true;
		} else if (strcmp(argv[i], "-w") == 0) {
			full = true;
		} else if (strcmp(argv[i], "-d") == 0) {
			dump = true;
		}
	}
	if (prepare(sh) != 0) {
		return -EINVAL;
	}
	bits = ofdm_frame_bits(&ctx, mod);
	link_mac_pause(true);
	for (uint32_t k = 0; k < n; k++) {
		struct esp_sdr_rx_burst b;
		struct ofdm_rx_info info;
		uint32_t t0 = cyc(), e = 0;

		/* Two frames hold a whole copy wherever the capture starts. */
		if (esp_sdr_rx_capture(RX_RATE, full ? WINDOW : MIN(WINDOW, 2U * ctx.rlen + ctx.rnfft),
				       &b) != 0) {
			continue;
		}
		cap_us += k_cyc_to_us_floor32(cyc() - t0);
		if (ofdm_rx_begin(&ctx, b.words, b.count, rx_hdr, &info) != 0) {
			continue;
		}
		found++;
		hbad += memcmp(rx_hdr, ref_hdr, sizeof(rx_hdr)) != 0;
		ofdm_rx_finish(&ctx, b.words, mod, rx_bits, &info);
		for (size_t i = 0; i < (bits + 7U) / 8U; i++) {
			uint8_t d = rx_bits[i] ^ ref_bits[i];

			if (i == (bits - 1U) / 8U && (bits & 7U) != 0U) {
				d &= (uint8_t)(0xffU << (8U - (bits & 7U)));
			}
			e += (uint32_t)__builtin_popcount(d);
		}
		errs += e;
		bad += e != 0U;
		if (dump && e != 0U) {
			/* The capture of this frame, as "link dump" prints it, then stop. */
			shell_print(sh, "frame with %u bit errors, start %d, MER %.1f dB", e, info.start,
				    (double)info.mer_db);
			shell_print(sh, "dump %u words", (unsigned int)b.count);
			for (size_t i = 0; i < b.count; i += 8) {
				char line[96];
				int len = 0;

				for (size_t j = i; j < MIN(i + 8U, b.count); j++) {
					len += snprintf(&line[len], sizeof(line) - len, "%08x ",
							b.words[j]);
				}
				shell_print(sh, "%s", line);
			}
			shell_print(sh, "dump end");
			n = k + 1U;
			break;
		}
		mer += info.mer_db;
		mer_min = MIN(mer_min, info.mer_db);
		cfo += info.cfo_hz;
		for (int i = 0; i < 3; i++) {
			prof[i] += k_cyc_to_us_floor32(info.prof[i]);
		}
	}
	link_mac_pause(false);
	shell_print(sh, "found %u/%u, header errors %u, frame errors %u, bit errors %llu/%llu "
		    "(BER %.2e)", found, n, hbad, bad, errs, (uint64_t)found * bits,
		    found ? (double)errs / ((double)found * (double)bits) : 0.0);
	if (found > 0) {
		shell_print(sh, "MER %.1f dB avg, %.1f min, cfo %.1f kHz; us per frame: search %llu, "
			    "channel+header %llu, data %llu (capture %llu)",
			    (double)(mer / found), (double)mer_min, (double)(cfo / found / 1e3f),
			    prof[0] / found, prof[1] / found, prof[2] / found, cap_us / n);
		if (verbose) {
			print_channel(sh);
		}
	}
	shell_print(sh, "rx done");
	return 0;
}

static int cmd_bench(const struct shell *sh, size_t argc, char **argv)
{
	const unsigned int rounds = 1000;
	uint32_t t0;

	ARG_UNUSED(argc);
	ARG_UNUSED(argv);
	if (prepare(sh) != 0) {
		return -EINVAL;
	}
	for (unsigned int i = 0; i < ctx.nfft; i++) {
		ctx.w0.buf[i] = (struct ofdm_cf){(float)(i % 7) - 3.0f, (float)(i % 5) - 2.0f};
	}
	t0 = cyc();
	for (unsigned int r = 0; r < rounds; r++) {
		ofdm_test_fft(&ctx);
	}
	t0 = cyc() - t0;
	shell_print(sh, "fft %u (%s): %.2f us", ctx.nfft,
		    IS_ENABLED(CONFIG_APP_OFDM_ESP_DSP) ? "esp-dsp" : "C",
		    (double)k_cyc_to_ns_floor64(t0) / 1e3 / rounds);
	/* RS(255,223) decode with e byte errors, on the stack. */
	for (unsigned int e = 0; e <= 10; e += (e == 0 ? 2 : (e == 2 ? 3 : 5))) {
		uint8_t ref[RS_N], cw[RS_N];
		uint32_t sum = 0;
		int r = 0;

		for (unsigned int i = 0; i < RS_K; i++) {
			ref[i] = (uint8_t)(i * 37U + 11U);
		}
		rs_encode(ref);
		for (unsigned int k = 0; k < 50; k++) {
			memcpy(cw, ref, RS_N);
			for (unsigned int j = 0; j < e; j++) {
				cw[(k * 31U + j * 23U) % RS_N] ^= (uint8_t)(j + 1U);
			}
			t0 = cyc();
			r = rs_decode(cw);
			sum += cyc() - t0;
		}
		shell_print(sh, "rs_decode, %u errors: %u us (returned %d)", e,
			    k_cyc_to_us_floor32(sum / 50U), r);
	}
	return 0;
}

SHELL_STATIC_SUBCMD_SET_CREATE(ofdm_cmds,
	SHELL_CMD(status, NULL, "Frame layout and settings", cmd_status),
	SHELL_CMD_ARG(set, NULL, "<bw|ch|cp|mod|amp|syms|rxdiv|fs|pilots|smooth> <value> ...", cmd_set,
		      3, 16),
	SHELL_CMD_ARG(tx, NULL, "Loop the test frame: [-t <s>]", cmd_tx, 1, 2),
	SHELL_CMD_ARG(rx, NULL, "Decode captures: [-n <captures>] [-v] [-w: whole window] "
		      "[-d: dump the first frame with errors]", cmd_rx, 1, 5),
	SHELL_CMD(bench, NULL, "Time one FFT", cmd_bench),
	SHELL_SUBCMD_SET_END);

SHELL_CMD_REGISTER(ofdm, &ofdm_cmds, "Raw OFDM test (MAC paused)", NULL);
```
