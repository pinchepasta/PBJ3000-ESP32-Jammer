## apps/common/Kconfig
```kconfig
# SPDX-License-Identifier: GPL-3.0-or-later
#
# USB start, DFU and the trial watchdog (common/src/app_usb.c).

config APP_USB_START_DELAY_MS
	int "Delay before USB OTG takes the PHY from USB-Serial-JTAG"
	default 0
	help
	  Until then the board stays on USB-Serial-JTAG, so esptool can still
	  reset it into the ROM bootloader with RTS/DTR. Updates normally go
	  over DFU; a few seconds here give a recovery path for images that
	  break USB outside of a DFU trial boot.

config APP_USB_DFU
	bool "USB DFU into the MCUboot secondary slot"
	default y
	depends on BOOTLOADER_MCUBOOT
	select USBD_DFU
	select FLASH
	select FLASH_MAP
	select STREAM_FLASH
	select IMG_MANAGER
	select IMG_ERASE_PROGRESSIVELY
	select REBOOT

if APP_USB_DFU

config USBD_DFU_FLASH
	default y

config USBD_DFU_FLASH_SLOT0
	default n

config USBD_DFU_FLASH_SLOT1
	default y

config APP_USB_DFU_PID
	hex "USB product ID in DFU mode"
	default 0xffff

config APP_TRIAL_WATCHDOG
	bool "Revert a DFU image the host does not confirm"
	default y
	select WATCHDOG
	select MCUBOOT_SHELL
	help
	  On a test boot after DFU, arm the hardware watchdog until the image
	  is confirmed, normally with "mcuboot confirm" on the USB shell. A
	  hang or a missing confirmation resets the chip; MCUboot reverts.

config APP_TRIAL_TIMEOUT_S
	int "Seconds the host has to confirm a DFU image"
	default 60
	depends on APP_TRIAL_WATCHDOG
	help
	  Passed to the watchdog as its timeout. The ESP32 driver currently
	  counts milliseconds as 0.5 ms ticks, so the reset comes after about
	  half of this.

endif # APP_USB_DFU

config APP_LIVENESS_WATCHDOG
	bool "Reset when the system hangs"
	select WATCHDOG
	help
	  Keeps the hardware watchdog armed, fed every 500 ms from the system
	  work queue: a wedged system resets instead of needing a replug. An
	  unconfirmed DFU image is fed for about half of
	  APP_TRIAL_TIMEOUT_S (the driver's tick scale), then reverts as before.

config APP_LIVENESS_TIMEOUT_MS
	int "Liveness watchdog timeout in ms"
	default 4000
	depends on APP_LIVENESS_WATCHDOG
	help
	  The ESP32 driver counts milliseconds as 0.5 ms ticks: 4000 resets
	  after about 2 s without feeding.
```

## boards/waveshare/esp32c5_zero/Kconfig
```kconfig
# SPDX-License-Identifier: GPL-3.0-or-later

config HEAP_MEM_POOL_ADD_SIZE_BOARD
	int
	default 4096 if BOARD_WAVESHARE_ESP32C5_ZERO_ESP32C5_HPCORE

config WAVESHARE_ESP32C5_ZERO_EXT_ANTENNA
	bool "Waveshare ESP32-C5-Zero: U.FL connector instead of the chip antenna"
	depends on BOARD_WAVESHARE_ESP32C5_ZERO_ESP32C5_HPCORE
	select BOARD_LATE_INIT_HOOK
	help
	  Drives GPIO26 (ANT_Ctrl) high at boot, which switches the RF path
	  to the U.FL connector. Unset, the pin stays an input and the board's
	  pull-down keeps the chip antenna.
```

## boards/waveshare/esp32c5_zero/Kconfig.waveshare_esp32c5_zero
```kconfig
# SPDX-License-Identifier: GPL-3.0-or-later

config BOARD_WAVESHARE_ESP32C5_ZERO
	select SOC_ESP32C5
	select SOC_ESP32C5_HPCORE if BOARD_WAVESHARE_ESP32C5_ZERO_ESP32C5_HPCORE
```

## boards/waveshare/esp32c5_zero/board.yml
```yaml
board:
  name: waveshare_esp32c5_zero
  full_name: Waveshare ESP32-C5-Zero
  vendor: waveshare
  socs:
  - name: esp32c5
```

## boards/waveshare/esp32c5_zero/dts/bindings/waveshare,esp32c5-zero-rf-switch.yaml
```yaml
# SPDX-License-Identifier: GPL-3.0-or-later

description: |
  Antenna switch of the Waveshare ESP32-C5-Zero: an SPDT RF switch between
  the chip antenna and the U.FL connector, controlled by ANT_Ctrl (GPIO26,
  200 kOhm pull-down). Active selects the U.FL connector.

compatible: "waveshare,esp32c5-zero-rf-switch"

properties:
  select-gpios:
    type: phandle-array
    required: true
    description: ANT_Ctrl; active selects the U.FL connector.
```

## boards/waveshare/esp32c5_zero/waveshare_esp32c5_zero_hpcore_defconfig
```kconfig
# SPDX-License-Identifier: GPL-3.0-or-later

CONFIG_CONSOLE=y
CONFIG_SERIAL=y
CONFIG_UART_CONSOLE=y
CONFIG_GPIO=y
```

## lib/Kconfig
```kconfig
# SPDX-License-Identifier: GPL-3.0-or-later

rsource "esp_sdr/Kconfig"
rsource "ieee802154/Kconfig"
```

## lib/esp_sdr/Kconfig
```kconfig
# SPDX-License-Identifier: GPL-3.0-or-later

config ESP_SDR
	bool "ESP-SDR raw I/Q receiver"
	depends on SOC_SERIES_ESP32S3 || SOC_SERIES_ESP32C6 || SOC_SERIES_ESP32C5
	depends on WIFI_ESP32
	# The bank and heap limits assume no APPCPU image in SRAM.
	depends on !SOC_ENABLE_APPCPU
	help
	  Burst capture of raw baseband I/Q samples from the Wi-Fi receiver,
	  ported from ESPARGOS esp-sdr. Reserves an SRAM bank for the capture
	  engine (64 KiB on the S3, the 128 KiB block 2 on the C6). The ESP32-C6 captures at 80 MS/s only, and
	  streams continuously, CPU-paced (ESP_SDR_PACED). The ESP32-C5 receives at 80 to 4 MS/s
	  into its 128 KiB block 1, which splits the image around it; no
	  transmit or ring support.

if ESP_SDR

config ESP_SDR_RFTEST
	bool "Espressif RF test library (fixed RX gain, TX power steps)"
	default y
	help
	  Links force_rx_gain(), force_tx_gain() and force_txon_mode() from
	  Espressif's librftest.a, fetched with "west blobs fetch
	  esp-sdr-zephyr". Without it the receiver runs on the hardware AGC
	  only and transmit keeps the PHY's own power setting.

config ESP_SDR_RX_DECIM
	bool "Decimated capture"
	default y
	help
	  esp_sdr_rx_capture_decimated(): a full capture filtered and
	  decimated by a third order CIC, for narrow band streams.
	  esp_sdr_rx_capture_folded(): the same capture folded (decimated in
	  frequency, aliasing the whole band down) instead of filtered, for a
	  wideband power/occupancy survey. Apps that work at the native rate
	  can leave it out.

config ESP_SDR_PACED
	bool "CPU-paced streaming (ESP32-C6, ESP32-C5)"
	default y
	depends on (SOC_SERIES_ESP32C6 || SOC_SERIES_ESP32C5) && ESP_SDR_RFTEST
	help
	  esp_sdr_rx_paced_*() and esp_sdr_tx_paced_*(): continuous receive
	  through the modem's IQ estimator and continuous transmit through the
	  TX DC value register, paced by the CPU from the caller's loop.

config ESP_SDR_BANK1
	bool "Reserve a second dump bank"
	depends on SOC_SERIES_ESP32S3
	help
	  Reserves SRAM bank 1 (0x3fcc0000) next to the capture bank, for
	  two-bank loop playback (esp_sdr_tx_loop_*()) and for captures into
	  either bank (esp_sdr_rx_capture_bank()). Costs another 64 KiB of
	  internal RAM.

config ESP_SDR_RING
	bool "Continuous ring receive"
	depends on SOC_SERIES_ESP32S3
	select ESP_SDR_BANK1
	help
	  esp_sdr_ring_run(): the dump engine in circular mode, rotated
	  through SRAM banks 0 to 2, and a two-stage decimating FIR on the
	  vector unit: gapless I/Q at 16 MS/s divided by 64 to 1024. Reserves
	  SRAM bank 0 (0x3fcb0000) besides banks 1 and 2, another 64 KiB of
	  internal RAM: the whole DRAM image must end below 0x3fcb0000.

config ESP_SDR_RING_BOX4
	bool "Ring decimation by 4 (boxcar, for 2 MHz wide signals)"
	depends on ESP_SDR_RING
	help
	  ESP_SDR_RING_DECIM_BOX4: -fs/4 mix and a boxcar of 4 (or every 4th
	  pair) instead of the FIR chain, for signals such as IEEE 802.15.4 at
	  4 MS/s. About 1 KiB of IRAM, which on the S3 comes out of the same
	  SRAM as the DRAM image: leave it out where that is tight.

config ESP_SDR_TX
	bool "Transmit backend interface"
	depends on SOC_SERIES_ESP32S3
	help
	  esp_sdr_tx_*() front end with a stub backend that consumes and
	  counts samples. A real backend registers with
	  esp_sdr_tx_set_backend().

config ESP_SDR_TX_DAC
	bool "DAC transmit backend"
	default y
	depends on ESP_SDR_TX && ESP_SPIRAM && ESP_SDR_RFTEST
	select ESP_SDR_BANK1
	help
	  Default backend: buffers input samples in PSRAM and interpolates
	  them to the 40 MS/s DAC rate in a player thread.

if ESP_SDR_TX_DAC

config ESP_SDR_TX_DAC_RING_SAMPLES
	int "Input ring size in samples (PSRAM, 4 bytes each, power of two)"
	default 262144

config ESP_SDR_TX_DAC_PREBUF_MS
	int "Input buffered before playback starts, in ms"
	default 20

config ESP_SDR_TX_DAC_SIMD
	bool "Interpolate with the ESP32-S3 vector unit"
	default y
	help
	  Four DAC words per instruction group (src/esp_sdr_pie.S). The
	  vector registers are not saved by Zephyr, so only the filler
	  threads may use them, with the scheduler locked meanwhile.

config ESP_SDR_TX_DAC_HIGH_RAM
	bool "Backend buffers and thread stacks above the capture bank"
	help
	  Puts the input staging buffer and the player and filler stacks
	  (about 7 KiB) in ESP_SDR_HIGH_RAM instead of the DRAM image, for
	  apps whose image must end below the ring banks.

config ESP_SDR_TX_DAC_STACK_SIZE
	int "Player and filler thread stack size"
	default 2048

config ESP_SDR_TX_DAC_PRIORITY
	int "Player thread priority"
	default 8
	help
	  Below the network and transmit receive threads, above the fillers:
	  it only copies ready blocks and restarts the DAC.

config ESP_SDR_TX_DAC_FILLER_PRIORITY
	int "Filler thread priority"
	default 5
	help
	  The leader fills one block per bank pass and sleeps until its switch
	  time, so it can sit above the application threads: any thread that
	  preempts it on its CPU for longer than the block tail (51 us) makes
	  the DAC restart.

config ESP_SDR_TX_DAC_LEADER_CPU
	int "CPU of the leading filler"
	range 0 1
	default 1
	help
	  The leader fills every block when the vector unit is available, the
	  other filler only helps the C fallback. Put the leader on the CPU
	  that is idle while transmitting: a transmit session holds the radio,
	  so receive capture waits and its processing CPU is free.

endif # ESP_SDR_TX_DAC

module = ESP_SDR
module-str = esp_sdr
source "subsys/logging/Kconfig.template.log_config"

endif # ESP_SDR
```

## lib/ieee802154/Kconfig
```kconfig
# SPDX-License-Identifier: GPL-3.0-or-later

config ESP_SDR_IEEE802154
	bool "IEEE 802.15.4 radio on esp_sdr"
	depends on ESP_SDR_TX_DAC && NETWORKING && IEEE802154 && HWINFO
	help
	  Software 2.4 GHz O-QPSK PHY and an ieee802154_radio_api driver
	  (device "esp_sdr_154"): receive gapless through the ring
	  (ESP_SDR_IEEE802154_RING) or from 16 MS/s bank captures, transmit
	  through the DAC backend. With CONFIG_NET_L2_IEEE802154 it is a
	  network interface; without, a plain device whose frames go to
	  ieee154_esp_sdr_set_rx_cb() (raw 802.15.4 mode would compile out
	  the interface layer the Wi-Fi driver needs). Waits for ACKs, sends
	  them with ESP_SDR_IEEE802154_AUTO_ACK; no CCA: see
	  doc/ieee802154.md. Needs CONFIG_IEEE802154 (packet fields) and
	  CONFIG_HWINFO (the extended address comes from the chip's id).

if ESP_SDR_IEEE802154

config ESP_SDR_IEEE802154_RING
	bool "Gapless receive through the ring"
	default y
	depends on ESP_SDR_RING && SMP
	select ESP_SDR_RING_BOX4
	help
	  The 16 MS/s ring decimated by 4 (ESP_SDR_RING_DECIM_BOX4) on CPU 1,
	  the PHY on CPU 0 through a sample ring in internal RAM. Without it, receive
	  uses separate bank captures of about 1 ms.

config ESP_SDR_IEEE802154_AUTO_ACK
	bool "Send ACKs"
	default y
	depends on ESP_SDR_IEEE802154_RING
	help
	  Acknowledge frames to this node that ask for it, from inside the
	  ring run (doc/ieee802154-ack.md): the ring rotates through two banks,
	  the third holds the ACK waveform, and the run stops at the end of
	  such a frame, plays the ACK 192 us after it once the PHY has checked
	  the FCS, and restarts. Not in promiscuous mode.

config ESP_SDR_IEEE802154_ACK_PRIORITY
	int "PHY thread priority while an ACK is armed"
	default 0
	depends on ESP_SDR_IEEE802154_AUTO_ACK
	help
	  From the frame's header to the verdict on its FCS (about 100 us
	  after its end) the PHY thread runs at this priority, so that no
	  other thread on CPU 0 delays the ACK.

config ESP_SDR_IEEE802154_HIGH_RAM_APP
	bool "Internal RAM from the application"
	help
	  The driver's buffers and thread stacks (about 22 KiB, otherwise in
	  the high region) come from ieee154_esp_sdr_high_ram(), which the
	  application defines, so it can use that RAM otherwise in boots
	  without the radio (apps/multiapp).

config ESP_SDR_IEEE802154_RX_PRIORITY
	int "Receive thread priority (ring or burst captures)"
	default 10

config ESP_SDR_IEEE802154_PHY_PRIORITY
	int "PHY thread priority with the ring"
	default 14
	help
	  The PHY drains the sample ring whenever samples wait. Keep it below
	  USB, network and shell threads: if it falls behind it drops samples
	  instead of starving them.

module = ESP_SDR_IEEE802154
module-str = esp_sdr_ieee802154
source "subsys/logging/Kconfig.template.log_config"

endif # ESP_SDR_IEEE802154
```

## tests/unit/iq_pack/testcase.yaml
```yaml
tests:
  unit.esp_sdr.iq_pack:
    tags:
      - esp-sdr
      - stream
    platform_allow:
      - native_sim
      - native_sim/native/64
    integration_platforms:
      - native_sim
```

## tests/unit/link_hamming/testcase.yaml
```yaml
tests:
  unit.esp_sdr.link_hamming:
    tags:
      - esp-sdr
      - link
    platform_allow:
      - native_sim
      - native_sim/native/64
    integration_platforms:
      - native_sim
```
