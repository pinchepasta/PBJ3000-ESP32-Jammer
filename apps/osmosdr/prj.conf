## CMakeLists.txt
```
# SPDX-License-Identifier: GPL-3.0-or-later

cmake_minimum_required(VERSION 3.20.0)

find_package(Zephyr REQUIRED HINTS $ENV{ZEPHYR_BASE})
project(esp_sdr_osmosdr)

include(${CMAKE_CURRENT_LIST_DIR}/../common/common.cmake)

target_sources(app PRIVATE
  src/main.c
  src/sdr.c
  src/shell.c
  src/usb_sdr.c)
set_source_files_properties(src/sdr.c PROPERTIES COMPILE_OPTIONS "-O3;-ffp-contract=fast")
```

## Kconfig
```
# SPDX-License-Identifier: GPL-3.0-or-later

mainmenu "ESP-SDR osmosdr"

config APP_FREQ_MHZ
	int "Centre frequency in MHz at boot"
	range 100 6000
	default 2450

config APP_RX_BW_MHZ
	int "Receive filter bandwidth in MHz at boot (0: widest, -1: the PHY's setting)"
	range -1 69
	default 13
	help
	  Two-sided, 13 to 69 MHz, as in apps/link (1 to 12 fail the build). The ring samples at
	  16 MS/s: the narrowest setting keeps the most of what lies beyond
	  +-8 MHz from aliasing into the stream. The host can change it
	  (SET_BANDWIDTH, where 0 selects the PHY's setting).

config APP_CBW
	int "PHY channel bandwidth mode (0: 20 MHz, 2: 40 MHz)"
	range 0 2
	default 0

config APP_RX_GAIN_MAX
	int "Largest receive gain index accepted"
	default 82

config APP_RX_BLOCKS
	int "Receive blocks of 4 KiB between the ring and USB"
	default 5
	help
	  At 250 kS/s each holds about 8 ms of 8-bit samples, 4 ms of
	  16-bit ones. USB DMA needs internal RAM. Transmit uses them as
	  its OUT buffers.

config APP_RX_HIGH_BLOCKS
	int "Of these, blocks in the SRAM above the capture bank"
	default 5
	help
	  ESP_SDR_HIGH_RAM, about 38 KiB, shared with the ring's filter
	  buffers, the transmit backend and the app's thread stacks; the rest
	  go to the DRAM image below the ring banks.

rsource "../common/Kconfig"

# USB device identity (VID, PID, strings) for the sample USB helper.
source "samples/subsys/usb/common/Kconfig.sample_usbd"

source "Kconfig.zephyr"
```

## sample.yaml
```
sample:
  name: ESP-SDR osmosdr
  description: >-
    USB SDR after HackRF's model: gapless decimated receive and transmit
    over vendor bulk endpoints, for osmosdr / GNU Radio hosts
common:
  tags: esp-sdr
  sysbuild: true
  platform_allow:
    - xiao_esp32s3/esp32s3/procpu
  integration_platforms:
    - xiao_esp32s3/esp32s3/procpu
tests:
  # Needs a host and boards: run tools/esdr_usb (see README).
  sample.esp_sdr.osmosdr:
    build_only: true
```

## sysbuild.conf
```
# MCUboot makes the secondary slot available for USB DFU updates.
SB_CONFIG_BOOTLOADER_MCUBOOT=y
```

## prj.conf
```kconfig
# The Wi-Fi driver brings the radio up at boot; nothing may scan or connect.
CONFIG_NETWORKING=y
CONFIG_WIFI=y
CONFIG_ESP32_WIFI_STA_POWER_SAVE_NONE=y
# No IP traffic: the network stack only carries the Wi-Fi driver, minimal.
CONFIG_NET_IPV6=n
CONFIG_NET_IPV4=y
CONFIG_NET_PKT_RX_COUNT=4
CONFIG_NET_PKT_TX_COUNT=4
CONFIG_NET_BUF_RX_COUNT=8
CONFIG_NET_BUF_TX_COUNT=8
CONFIG_NET_RX_STACK_SIZE=1024

CONFIG_ESP_SDR=y
# Continuous receive: three dump banks, so the DRAM image ends below 0x3fcb0000.
CONFIG_ESP_SDR_RING=y
CONFIG_ESP_SDR_RX_DECIM=n
# Transmit: the DAC backend (PSRAM input ring, gapless loop playback), its
# buffers and stacks above the capture bank.
CONFIG_ESP_SDR_TX=y
CONFIG_ESP_SDR_TX_DAC=y
CONFIG_ESP_SDR_TX_DAC_HIGH_RAM=y

CONFIG_LOG=y
CONFIG_LOG_MODE_DEFERRED=y
# Few messages; the DRAM image is tight.
CONFIG_LOG_BUFFER_SIZE=512

# Filter design at run start, the fine tuning NCO.
CONFIG_FPU=y
CONFIG_FPU_SHARING=y
CONFIG_MAIN_STACK_SIZE=1536
# Below the default 2048 per CPU, which the DRAM image cannot spare (peak 512).
CONFIG_ISR_STACK_SIZE=1024

CONFIG_SMP=y
CONFIG_SCHED_CPU_MASK=y

# USB device on the OTG port: the SDR function, shell on CDC-ACM, DFU with
# sysbuild/MCUboot.
CONFIG_USB_DEVICE_STACK_NEXT=y
CONFIG_SAMPLE_USBD_PRODUCT="ESP-SDR osmosdr"
# Same PID as the other apps (host udev rules); told apart by the vendor interface.
CONFIG_SAMPLE_USBD_PID=0x0005
CONFIG_USBD_LOG_LEVEL_WRN=y
CONFIG_UDC_DRIVER_LOG_LEVEL_WRN=y
CONFIG_USBD_THREAD_STACK_SIZE=2048
CONFIG_UDC_DWC2_STACK_SIZE=1280
CONFIG_USBD_CDC_ACM_CLASS=y
# CDC-ACM carries the console and the shell: its own logging must stay off (it would log to
# itself), which usbd_cdc_acm.c otherwise enforces with a #warning that -Werror makes fatal.
CONFIG_USBD_CDC_ACM_LOG_LEVEL_OFF=y
CONFIG_CDC_ACM_SERIAL_INITIALIZE_AT_BOOT=n

CONFIG_SHELL=y
CONFIG_KERNEL_SHELL=y
CONFIG_LOG_BACKEND_UART=n
CONFIG_SHELL_STACK_SIZE=2560
CONFIG_SHELL_CMD_BUFF_SIZE=128
CONFIG_SHELL_HISTORY=n
CONFIG_SHELL_BACKEND_SERIAL_LOG_MESSAGE_QUEUE_SIZE=256
CONFIG_DEVICE_SHELL=n
CONFIG_DATE_SHELL=n
CONFIG_DEVMEM_SHELL=y
# Wi-Fi management commands would retune the radio under the stream.
CONFIG_NET_L2_WIFI_SHELL=n

# Internal RAM: three 64 KiB dump banks must fit. The Wi-Fi heap goes to the
# 8 MB octal PSRAM.
CONFIG_ESP_SPIRAM=y
CONFIG_SPIRAM_MODE_OCT=y
CONFIG_ESP_WIFI_HEAP_SPIRAM=y
CONFIG_ESP32_WIFI_STATIC_RX_BUFFER_NUM=4
CONFIG_ESP32_WIFI_MGMT_SBUF_NUM=8
CONFIG_ESP32_WIFI_EVENT_TASK_STACK_SIZE=1024
CONFIG_NET_MGMT_EVENT_STACK_SIZE=1024
CONFIG_HEAP_MEM_POOL_IGNORE_MIN=y
CONFIG_HEAP_MEM_POOL_SIZE=17408
CONFIG_SYS_HEAP_RUNTIME_STATS=y

CONFIG_RESET_ON_FATAL_ERROR=y
CONFIG_APP_LIVENESS_WATCHDOG=y
```

## boards/xiao_esp32s3_procpu.overlay
```dts
/*
 * SPDX-License-Identifier: GPL-3.0-or-later
 */

/ {
	chosen {
		zephyr,console = &cdc_acm_uart0;
		zephyr,shell-uart = &cdc_acm_uart0;
	};
};

zephyr_udc0: &usb_otg {
	status = "okay";

	/* Console, shell and logs while OTG owns the USB port. */
	cdc_acm_uart0: cdc_acm_uart0 {
		compatible = "zephyr,cdc-acm-uart";
		label = "ESP-SDR osmosdr shell";
	};
};
```

## src/main.c
```c
/*
 * SPDX-License-Identifier: GPL-3.0-or-later
 *
 * USB SDR after HackRF's model, for osmosdr / GNU Radio hosts: a vendor
 * interface with control requests and bulk sample endpoints (esdr_proto.h),
 * next to the CDC-ACM shell and DFU. The receive ring owns CPU 1; the system
 * threads and USB stay on CPU 0.
 */

#include <zephyr/app_version.h>
#include <zephyr/kernel.h>
#include <zephyr/logging/log.h>

#include "app_cpu.h"
#include "app_usb.h"
#include "sdr.h"

LOG_MODULE_REGISTER(osmosdr, LOG_LEVEL_INF);

int main(void)
{
	printk("osmosdr %s\n", APP_VERSION_STRING);
	/* Before USB starts: its controller interrupt lands on the CPU that allocates it. */
	app_cpu_pin_system_threads(0);
	if (app_usb_init() != 0) {
		LOG_ERR("usb init failed");
	}
	if (sdr_init() != 0) {
		LOG_ERR("sdr init failed");
		return 0;
	}
	/* Again for the threads started since (usbd, UDC). */
	k_sleep(K_MSEC(500));
	app_cpu_pin_system_threads(0);
	return 0;
}
```

## src/esdr_proto.h
```c
/*
 * SPDX-License-Identifier: GPL-3.0-or-later
 *
 * USB protocol of the osmosdr app, shared with the host tools: vendor
 * control requests to the device (recipient device) set the radio, bulk
 * endpoints carry the samples, after HackRF's model.
 *
 * - Bulk IN (0x81): receive blocks of ESDR_BLOCK_BYTES, a header then
 *   interleaved I/Q (int8, or int16 little endian). The device sends whole
 *   blocks (multiples of 64 bytes, no short packets), so any read size that
 *   is a multiple of ESDR_BLOCK_BYTES stays aligned to them.
 * - Bulk OUT: transmit samples, interleaved I/Q in the format set (int8, or
 *   int16 little endian), at the sample rate set. The device takes them as
 *   fast as the DAC plays them: USB flow control paces the host, about 50 ms
 *   ahead. Input that runs out plays as zeros.
 *
 * All multi-byte fields are little endian. Plain C99, no Zephyr headers.
 */

#ifndef ESDR_PROTO_H_
#define ESDR_PROTO_H_

#include <stdint.h>

#define ESDR_PROTO_VERSION 1U

/* Vendor requests (bRequest). */
enum esdr_req {
	/* IN: struct esdr_info. */
	ESDR_REQ_GET_INFO = 0x01,
	/* wValue: enum esdr_mode. */
	ESDR_REQ_SET_MODE = 0x02,
	/* OUT 8 bytes: centre frequency in Hz (uint64_t). */
	ESDR_REQ_SET_FREQ = 0x03,
	/* OUT 4 bytes: sample rate in Hz (uint32_t); the nearest supported one is taken. */
	ESDR_REQ_SET_SAMPLE_RATE = 0x04,
	/* wValue: PHY gain index (0 to info.rx_gain_max), or ESDR_GAIN_AUTO. */
	ESDR_REQ_SET_RX_GAIN = 0x05,
	/* wValue: transmit power step (0 weakest to info.tx_gain_max). */
	ESDR_REQ_SET_TX_GAIN = 0x06,
	/* OUT 4 bytes: analog low-pass bandwidth in Hz (uint32_t), 0 for automatic. */
	ESDR_REQ_SET_BANDWIDTH = 0x07,
	/* wValue: bits per I and Q item, 8 or 16. */
	ESDR_REQ_SET_FORMAT = 0x08,
	/* OUT 4 bytes: crystal correction in parts per billion (int32_t). */
	ESDR_REQ_SET_FREQ_CORR = 0x09,
	/* IN: struct esdr_state. */
	ESDR_REQ_GET_STATE = 0x0a,
	/* IN: struct esdr_stats. */
	ESDR_REQ_GET_STATS = 0x0b,
	/* wValue: ESDR_OPT_* bits. */
	ESDR_REQ_SET_OPTIONS = 0x0c,
	/*
	 * wValue: digital gain in dB before the items are rounded, a multiple of
	 * 6 up to ESDR_DGAIN_MAX_DB, or ESDR_DGAIN_DEFAULT (24 dB at 8 bit, 0 at
	 * 16). Decimation leaves a quiet band's noise far below an 8-bit item.
	 */
	ESDR_REQ_SET_DIGITAL_GAIN = 0x0d,
};

enum esdr_mode {
	ESDR_MODE_OFF = 0,
	ESDR_MODE_RX = 1,
	ESDR_MODE_TX = 2,
	/* Throughput tests: IN sends counting blocks as fast as the bus takes them, OUT sinks. */
	ESDR_MODE_TEST_IN = 0x10,
	ESDR_MODE_TEST_OUT = 0x11,
};

#define ESDR_GAIN_AUTO 0xffffU
#define ESDR_DGAIN_DEFAULT 0xffffU
#define ESDR_DGAIN_MAX_DB  42U

/*
 * Offset tuning (default on): the LO sits 4 MHz below the centre and the
 * stream is mixed down digitally, so the LO leakage and the 1/f noise at
 * the LO stay outside the output band.
 */
#define ESDR_OPT_OFFSET_TUNING 0x0001U

#define ESDR_INFO_MAGIC 0x52445345U /* "ESDR" */

struct esdr_info {
	uint32_t magic;
	uint16_t proto_version;
	uint16_t info_size;
	char firmware[32];
	uint64_t freq_min_hz, freq_max_hz;
	/* Supported receive rates: rx_rate_max_hz >> k for k = 0 .. rx_rate_count - 1. */
	uint32_t rx_rate_max_hz;
	uint16_t rx_rate_count;
	uint16_t rx_gain_max;
	uint16_t tx_gain_max;
	uint16_t block_bytes;
	/* Full scale of the 16-bit items (8-bit items: 128). */
	uint16_t full_scale16;
	uint16_t reserved;
} __attribute__((packed));

struct esdr_state {
	uint16_t mode;
	uint16_t bits;
	uint16_t options;
	/* Gain index or ESDR_GAIN_AUTO; transmit step. */
	uint16_t rx_gain, tx_gain;
	/* Digital gain in dB as applied. */
	uint16_t digital_gain_db;
	/* Requested centre, and where the stream is actually centred (Hz, rounded). */
	uint64_t freq_hz;
	uint64_t center_hz;
	uint32_t sample_rate_hz;
	uint32_t bandwidth_hz;
	int32_t freq_corr_ppb;
	/* LO as programmed (MHz plus kHz offset). */
	uint32_t lo_mhz;
	int32_t lo_offset_khz;
} __attribute__((packed));

struct esdr_stats {
	/* Samples delivered to USB, and samples dropped for want of free blocks. */
	uint64_t rx_samples, rx_overflow_samples;
	/* Input lost in the ring (filter too slow), and samples lost to restarts. */
	uint64_t rx_ring_lost_pairs, rx_restart_samples;
	uint64_t usb_in_bytes, usb_out_bytes;
	uint32_t rx_blocks, rx_overflows;
	uint32_t ring_runs, ring_errors, ring_late_max, ring_cycles_x100;
	uint32_t ring_abandoned, ring_gain_refreshed;
	/* Last ring error (enum esp_sdr_ring_status) and its detail. */
	uint32_t ring_last_status, ring_last_detail;
	/* Transmit: samples played, and dropped (late, or lost in a DAC restart). */
	uint64_t tx_samples, tx_dropped;
	/* Blocks the DAC played short of input (zero filled), sessions, DAC restarts. */
	uint32_t tx_underruns, tx_sessions, tx_restarts;
	/* Largest backlog of samples waiting for the DAC. */
	uint32_t tx_queued_max;
} __attribute__((packed));

#define ESDR_BLOCK_BYTES 4096U
#define ESDR_BLOCK_MAGIC 0x4b4c4245U /* "EBLK" */

/* Block flags. */
/* The block's index does not follow the previous block's: samples are missing before it. */
#define ESDR_BLK_GAP      0x0001U
/* Blocks were dropped before this one (the host did not read in time). */
#define ESDR_BLK_OVERFLOW 0x0002U
/* Items are int16 (else int8). */
#define ESDR_BLK_16BIT    0x0004U
/* Counting test pattern, not samples. */
#define ESDR_BLK_TEST     0x0008U

struct esdr_block_hdr {
	uint32_t magic;
	uint16_t flags;
	/* Complex samples in this block. */
	uint16_t samples;
	/* Index of the first sample on the stream's time axis (rate since the stream started). */
	uint64_t index;
} __attribute__((packed));

#define ESDR_BLOCK_PAYLOAD (ESDR_BLOCK_BYTES - sizeof(struct esdr_block_hdr))

/*
 * Serial transport (apps/osmosdr_serial, ESP32-C6 over USB-Serial-JTAG: one
 * byte stream each way). The vendor requests travel as frames: struct
 * esdr_ser_hdr, then len bytes.
 *
 * - Host to device: req is an enum esdr_req. An OUT request carries its data
 *   (len bytes) and wValue; an IN request (ESDR_SER_IN) carries none, len is
 *   the most it accepts. ESDR_SER_TX_DATA frames carry transmit samples.
 * - Device to host: every request gets one reply frame with the same req,
 *   status 0 or a negative errno, and the IN data. Receive blocks (as on USB,
 *   starting with ESDR_BLOCK_MAGIC) come between frames, never inside one.
 *
 * A request other than ESDR_SER_TX_DATA stops a running stream for as long as
 * it takes to apply it; the next receive block then carries ESDR_BLK_GAP.
 */
#define ESDR_SER_MAGIC 0x4c525345U /* "ESRL" */
#define ESDR_SER_IN      0x01U
#define ESDR_SER_TX_DATA 0x80U
#define ESDR_SER_MAX_DATA 512U

struct esdr_ser_hdr {
	uint32_t magic;
	uint8_t req;
	uint8_t flags;
	uint16_t value;
	uint16_t len;
	int16_t status;
} __attribute__((packed));

#endif /* ESDR_PROTO_H_ */
```

## src/sdr.h
```c
/*
 * SPDX-License-Identifier: GPL-3.0-or-later
 */

#ifndef SDR_H_
#define SDR_H_

#include <stdint.h>

#include <stdbool.h>

#include <esp_sdr/esp_sdr_ring.h>

#include "esdr_proto.h"

/* Settings as requested by the host. */
struct sdr_settings {
	uint16_t mode, bits, options;
	uint16_t rx_gain, tx_gain;
	/* dB, or ESDR_DGAIN_DEFAULT. */
	uint16_t dgain;
	uint64_t freq_hz;
	uint32_t rate_hz, bandwidth_hz;
	int32_t corr_ppb;
};

/* Bring the radio up and start the receive and USB threads. */
int sdr_init(void);

void sdr_get_settings(struct sdr_settings *s);
/* Digital gain in dB for these settings. */
unsigned int sdr_dgain_db(const struct sdr_settings *s);
void sdr_get_stats(struct esdr_stats *s);
/* Filter timing with a null sink or the stream's, in mode off. */
int sdr_bench(unsigned int decim, bool real_sink, bool rot, struct esp_sdr_ring_bench_result *r);

#endif /* SDR_H_ */
```

## src/shell.c
```c
/*
 * SPDX-License-Identifier: GPL-3.0-or-later
 *
 * "sdr" shell commands: settings and counters.
 */

#include <stdlib.h>

#include <zephyr/shell/shell.h>

#include <esp_sdr/esp_sdr.h>

#include "sdr.h"

static int cmd_status(const struct shell *sh, size_t argc, char **argv)
{
	struct sdr_settings s;
	struct esdr_stats st;
	struct esp_sdr_stats d;

	ARG_UNUSED(argc);
	ARG_UNUSED(argv);
	sdr_get_settings(&s);
	sdr_get_stats(&st);
	esp_sdr_get_stats(&d);
	shell_print(sh, "mode %u, %u bit, %u Hz at %llu Hz, gain %u, digital %u dB, bw %u Hz, "
		    "corr %d ppb, opt 0x%x",
		    s.mode, s.bits, s.rate_hz, (unsigned long long)s.freq_hz, s.rx_gain,
		    sdr_dgain_db(&s), s.bandwidth_hz, s.corr_ppb, s.options);
	shell_print(sh, "rx: %llu samples, %u blocks, %llu overflowed (%u times), %llu restart gap",
		    (unsigned long long)st.rx_samples, st.rx_blocks,
		    (unsigned long long)st.rx_overflow_samples, st.rx_overflows,
		    (unsigned long long)st.rx_restart_samples);
	shell_print(sh, "ring: %u runs, %u errors (last %u/0x%08x), %u abandoned, %llu pairs lost, "
		    "late max %u, %u.%02u cycles/pair, gain re-forced %u",
		    st.ring_runs, st.ring_errors, st.ring_last_status, st.ring_last_detail,
		    st.ring_abandoned, (unsigned long long)st.rx_ring_lost_pairs, st.ring_late_max,
		    st.ring_cycles_x100 / 100U, st.ring_cycles_x100 % 100U, st.ring_gain_refreshed);
	shell_print(sh, "usb: %llu bytes in, %llu bytes out", (unsigned long long)st.usb_in_bytes,
		    (unsigned long long)st.usb_out_bytes);
	return 0;
}

static int cmd_bench(const struct shell *sh, size_t argc, char **argv)
{
	unsigned int decim = argc > 1 ? strtoul(argv[1], NULL, 0) : 64U;
	struct esp_sdr_ring_bench_result r;

	for (int v = 0; v < 3; v++) {
		int ret = sdr_bench(decim, v == 1, v == 2, &r);

		if (ret != 0) {
			shell_error(sh, "bench: %d", ret);
			return ret;
		}
		shell_print(sh, "%-10s %u.%02u cycles/pair: unpack %u.%02u, stage 1 %u.%02u, "
			    "stage 2 %u.%02u, sink %u.%02u (%u samples)",
			    v == 0 ? "null sink" : v == 1 ? "real sink" : "fs/4 mix",
			    r.cycles_x100 / 100U, r.cycles_x100 % 100U, r.stage_x100[0] / 100U,
			    r.stage_x100[0] % 100U, r.stage_x100[1] / 100U, r.stage_x100[1] % 100U,
			    r.stage_x100[2] / 100U, r.stage_x100[2] % 100U, r.stage_x100[3] / 100U,
			    r.stage_x100[3] % 100U, r.samples);
	}
	return 0;
}

SHELL_STATIC_SUBCMD_SET_CREATE(sdr_cmds,
	SHELL_CMD_ARG(bench, NULL, "[decimation]: filter cycles per input pair", cmd_bench, 1, 1),
	SHELL_CMD(status, NULL, "Settings and counters", cmd_status),
	SHELL_SUBCMD_SET_END);
SHELL_CMD_REGISTER(sdr, &sdr_cmds, "USB SDR", NULL);
```

## src/usb_sdr.c
```c
/*
 * SPDX-License-Identifier: GPL-3.0-or-later
 *
 * Vendor USB function of the SDR (usb_sdr.h): one interface, bulk IN for
 * receive blocks, bulk OUT for transmit samples. Transfers point at the
 * app's own buffers (net_buf_alloc_with_data), so no data is copied here.
 * Control requests to the device are claimed by bRequest and passed to the
 * app.
 */

#include <errno.h>
#include <string.h>

#include <zephyr/drivers/usb/udc.h>
#include <zephyr/kernel.h>
#include <zephyr/logging/log.h>
#include <zephyr/sys/atomic.h>
#include <zephyr/usb/usbd.h>

#include "esdr_proto.h"
#include "usb_sdr.h"

LOG_MODULE_REGISTER(usb_sdr, LOG_LEVEL_INF);

/* Bulk transfers in flight on both endpoints together. */
#define SDR_XFERS 16

UDC_BUF_POOL_DEFINE(sdr_ep_pool, SDR_XFERS, 0, sizeof(struct udc_buf_info), NULL);

static const struct usbd_cctx_vendor_req sdr_vregs = USBD_VENDOR_REQ(
	ESDR_REQ_GET_INFO, ESDR_REQ_SET_MODE, ESDR_REQ_SET_FREQ, ESDR_REQ_SET_SAMPLE_RATE,
	ESDR_REQ_SET_RX_GAIN, ESDR_REQ_SET_TX_GAIN, ESDR_REQ_SET_BANDWIDTH, ESDR_REQ_SET_FORMAT,
	ESDR_REQ_SET_FREQ_CORR, ESDR_REQ_GET_STATE, ESDR_REQ_GET_STATS, ESDR_REQ_SET_OPTIONS,
	ESDR_REQ_SET_DIGITAL_GAIN);

struct sdr_desc {
	struct usb_if_descriptor if0;
	struct usb_ep_descriptor in_ep;
	struct usb_ep_descriptor out_ep;
	struct usb_desc_header nil_desc;
};

static struct sdr_desc sdr_desc = {
	.if0 = {
		.bLength = sizeof(struct usb_if_descriptor),
		.bDescriptorType = USB_DESC_INTERFACE,
		.bInterfaceNumber = 0,
		.bAlternateSetting = 0,
		.bNumEndpoints = 2,
		.bInterfaceClass = USB_BCC_VENDOR,
		.bInterfaceSubClass = 0,
		.bInterfaceProtocol = 0,
		.iInterface = 0,
	},
	.in_ep = {
		.bLength = sizeof(struct usb_ep_descriptor),
		.bDescriptorType = USB_DESC_ENDPOINT,
		.bEndpointAddress = 0x81,
		.bmAttributes = USB_EP_TYPE_BULK,
		.wMaxPacketSize = sys_cpu_to_le16(64U),
		.bInterval = 0,
	},
	.out_ep = {
		.bLength = sizeof(struct usb_ep_descriptor),
		.bDescriptorType = USB_DESC_ENDPOINT,
		.bEndpointAddress = 0x01,
		.bmAttributes = USB_EP_TYPE_BULK,
		.wMaxPacketSize = sys_cpu_to_le16(64U),
		.bInterval = 0,
	},
	.nil_desc = {
		.bLength = 0,
		.bDescriptorType = 0,
	},
};

static const struct usb_desc_header *const sdr_fs_desc[] = {
	(struct usb_desc_header *)&sdr_desc.if0,
	(struct usb_desc_header *)&sdr_desc.in_ep,
	(struct usb_desc_header *)&sdr_desc.out_ep,
	(struct usb_desc_header *)&sdr_desc.nil_desc,
};

static struct usbd_class_data *sdr_c_data;
static atomic_t sdr_up;

bool usb_sdr_enabled(void)
{
	return atomic_get(&sdr_up) != 0;
}

static int submit(uint8_t ep, uint8_t *data, size_t len, bool in)
{
	struct net_buf *buf;
	struct udc_buf_info *bi;
	int err;

	if (!usb_sdr_enabled()) {
		return -ENOTCONN;
	}
	buf = net_buf_alloc_with_data(&sdr_ep_pool, data, len, K_NO_WAIT);
	if (buf == NULL) {
		return -ENOMEM;
	}
	if (!in) {
		/* Empty: the controller writes what the host sends. */
		buf->len = 0;
	}
	bi = udc_get_buf_info(buf);
	memset(bi, 0, sizeof(*bi));
	bi->ep = ep;
	err = usbd_ep_enqueue(sdr_c_data, buf);
	if (err != 0) {
		net_buf_unref(buf);
	}
	return err;
}

int usb_sdr_submit_in(uint8_t *data, size_t len)
{
	return submit(sdr_desc.in_ep.bEndpointAddress, data, len, true);
}

int usb_sdr_submit_out(uint8_t *data, size_t cap)
{
	return submit(sdr_desc.out_ep.bEndpointAddress, data, cap, false);
}

void usb_sdr_cancel(void)
{
	if (sdr_c_data == NULL) {
		return;
	}
	(void)usbd_ep_dequeue(usbd_class_get_ctx(sdr_c_data), sdr_desc.in_ep.bEndpointAddress);
	(void)usbd_ep_dequeue(usbd_class_get_ctx(sdr_c_data), sdr_desc.out_ep.bEndpointAddress);
}

static int sdr_request(struct usbd_class_data *const c_data, struct net_buf *buf, int err)
{
	struct udc_buf_info *bi = udc_get_buf_info(buf);
	uint8_t *data = buf->__buf;
	size_t len = buf->len;
	uint8_t ep = bi->ep;

	ARG_UNUSED(c_data);
	net_buf_unref(buf);
	if (ep == sdr_desc.in_ep.bEndpointAddress) {
		usb_sdr_in_done(data, len, err);
	} else if (ep == sdr_desc.out_ep.bEndpointAddress) {
		usb_sdr_out_done(data, len, err);
	}
	return 0;
}

static struct net_buf *sdr_control_to_host(struct usbd_class_data *c_data,
					   const struct usb_setup_packet *const setup)
{
	struct net_buf *buf;
	int len;

	if (setup->RequestType.recipient != USB_REQTYPE_RECIPIENT_DEVICE) {
		return NULL;
	}
	buf = usbd_ep_ctrl_data_in_alloc(usbd_class_get_ctx(c_data), setup->wLength);
	if (buf == NULL) {
		return NULL;
	}
	len = usb_sdr_control_in(setup->bRequest, setup->wValue, buf->data,
				 MIN(setup->wLength, net_buf_tailroom(buf)));
	if (len < 0) {
		net_buf_unref(buf);
		return NULL;
	}
	net_buf_add(buf, len);
	return buf;
}

static int sdr_control_to_dev(struct usbd_class_data *c_data,
			      const struct usb_setup_packet *const setup,
			      const struct net_buf *const buf)
{
	ARG_UNUSED(c_data);

	if (setup->RequestType.recipient != USB_REQTYPE_RECIPIENT_DEVICE) {
		return -ENOTSUP;
	}
	if (setup->wLength == 0U) {
		return usb_sdr_control_out(setup->bRequest, setup->wValue, NULL, 0);
	}
	if (buf == NULL) {
		/* Setup stage: accept the data stage, handled when it arrives. */
		return 0;
	}
	return usb_sdr_control_out(setup->bRequest, setup->wValue, buf->data, buf->len);
}

static const void *sdr_get_desc(struct usbd_class_data *const c_data, const enum usbd_speed speed)
{
	ARG_UNUSED(c_data);
	ARG_UNUSED(speed);
	return sdr_fs_desc;
}

static void sdr_enable(struct usbd_class_data *const c_data)
{
	sdr_c_data = c_data;
	atomic_set(&sdr_up, 1);
	LOG_INF("interface enabled (in 0x%02x, out 0x%02x)", sdr_desc.in_ep.bEndpointAddress,
		sdr_desc.out_ep.bEndpointAddress);
	usb_sdr_link(true);
}

static void sdr_disable(struct usbd_class_data *const c_data)
{
	ARG_UNUSED(c_data);
	atomic_set(&sdr_up, 0);
	LOG_INF("interface disabled");
	usb_sdr_link(false);
}

static int sdr_init(struct usbd_class_data *c_data)
{
	sdr_c_data = c_data;
	return 0;
}

static const struct usbd_class_api sdr_api = {
	.request = sdr_request,
	.control_to_host = sdr_control_to_host,
	.control_to_dev = sdr_control_to_dev,
	.get_desc = sdr_get_desc,
	.enable = sdr_enable,
	.disable = sdr_disable,
	.init = sdr_init,
};

USBD_DEFINE_CLASS(esp_sdr_usb, &sdr_api, NULL, &sdr_vregs);
```

## src/usb_sdr.h
```c
/*
 * SPDX-License-Identifier: GPL-3.0-or-later
 *
 * The SDR's USB function: one vendor interface with a bulk IN and a bulk OUT
 * endpoint, and the vendor control requests of esdr_proto.h.
 */

#ifndef USB_SDR_H_
#define USB_SDR_H_

#include <stdbool.h>
#include <stddef.h>
#include <stdint.h>

/* Whether the host has configured the interface (bulk transfers possible). */
bool usb_sdr_enabled(void);

/*
 * Queue @p len bytes at @p data (internal RAM, stays untouched until done) on
 * bulk IN, or a receive buffer of @p cap bytes on bulk OUT. Completion calls
 * the handlers below from the USB stack thread, in order per endpoint.
 */
int usb_sdr_submit_in(uint8_t *data, size_t len);
int usb_sdr_submit_out(uint8_t *data, size_t cap);
/* Cancel everything queued on both endpoints (completions report -ECONNABORTED). */
void usb_sdr_cancel(void);

/* Provided by the app. */
void usb_sdr_in_done(uint8_t *data, size_t len, int err);
void usb_sdr_out_done(uint8_t *data, size_t len, int err);
/* Interface enabled (alternate setting 0 selected) or gone. */
void usb_sdr_link(bool up);
/*
 * Vendor requests: to the device with @p len bytes of data (0 for none), or
 * to the host filling at most @p max bytes (return the length). Called from
 * the USB stack thread: must not block. Negative errno stalls.
 */
int usb_sdr_control_out(uint8_t req, uint16_t value, const uint8_t *data, size_t len);
int usb_sdr_control_in(uint8_t req, uint16_t value, uint8_t *buf, size_t max);

#endif /* USB_SDR_H_ */
```
