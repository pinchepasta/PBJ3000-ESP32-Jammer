## CMakeLists.txt
```
# SPDX-License-Identifier: GPL-3.0-or-later
#
# Hardware integration test of the esp_sdr receive API's contract (error
# codes, boundary values) on a real board. See doc/testing.md.
#
# apps/common is only needed by the S3 variant (USB shell and DFU, see
# Kconfig); same if(CONFIG_USB_DEVICE_STACK_NEXT) guard every app uses.

cmake_minimum_required(VERSION 3.20.0)

find_package(Zephyr REQUIRED HINTS $ENV{ZEPHYR_BASE})
project(esp_sdr_rx_api)

if(CONFIG_USB_DEVICE_STACK_NEXT)
  include(${CMAKE_CURRENT_LIST_DIR}/../../../apps/common/common.cmake)
endif()

target_sources(app PRIVATE src/main.c)
```

## Kconfig
```
# SPDX-License-Identifier: GPL-3.0-or-later
#
# Only needed for the S3 variant (USB shell and DFU, see sysbuild.conf and
# boards/xiao_esp32s3_procpu.overlay): the chip currently runs an app that
# owns the USB OTG port for CDC-ACM, so esptool can no longer reset it into
# the ROM bootloader over that port; this test is deployed with `west dfu`
# like every other S3 app in this repo instead. The C6 variant does not
# build sysbuild and never uses this.

mainmenu "ESP-SDR RX API integration test"

rsource "../../../apps/common/Kconfig"

source "samples/subsys/usb/common/Kconfig.sample_usbd"

source "Kconfig.zephyr"
```

## sysbuild.conf
```
# MCUboot makes the secondary slot available for USB DFU updates (S3 variant only;
# see Kconfig).
SB_CONFIG_BOOTLOADER_MCUBOOT=y
```

## prj.conf
```kconfig
# The Wi-Fi driver brings the radio up at boot; nothing may scan or connect.
CONFIG_NETWORKING=y
CONFIG_WIFI=y
CONFIG_ESP32_WIFI_STA_POWER_SAVE_NONE=y

CONFIG_ESP_SDR=y
CONFIG_ZTEST=y
CONFIG_MAIN_STACK_SIZE=4096
```

## boards/xiao_esp32c6_hpcore.conf
```kconfig
# The XIAO RF switch to the U.FL coax port instead of the chip antenna.
CONFIG_XIAO_ESP32C6_EXT_ANTENNA=y
```

## boards/xiao_esp32s3_procpu.conf
```kconfig
CONFIG_FPU=y
CONFIG_FPU_SHARING=y

# USB device on the OTG port: shell on CDC-ACM, DFU with sysbuild/MCUboot (the chip
# currently runs an app that owns this port; see Kconfig and sysbuild.conf).
CONFIG_USB_DEVICE_STACK_NEXT=y
CONFIG_SAMPLE_USBD_PRODUCT="ESP-SDR RX API test"
CONFIG_SAMPLE_USBD_PID=0x0005
CONFIG_USBD_LOG_LEVEL_WRN=y
CONFIG_UDC_DRIVER_LOG_LEVEL_WRN=y
CONFIG_USBD_CDC_ACM_CLASS=y
CONFIG_CDC_ACM_SERIAL_INITIALIZE_AT_BOOT=n
CONFIG_LOG_BACKEND_UART=n
CONFIG_USBD_CDC_ACM_WORKQUEUE=y

CONFIG_SHELL=y
CONFIG_KERNEL_SHELL=y
CONFIG_SHELL_BACKEND_SERIAL_LOG_MESSAGE_QUEUE_SIZE=256
```

## boards/xiao_esp32s3_procpu.overlay
```dts
/*
 * SPDX-License-Identifier: GPL-3.0-or-later
 */

/ {
	chosen {
		zephyr,console = &cdc_acm_uart0;
		zephyr,shell-uart = &cdc_acm_uart0;
	};
};

zephyr_udc0: &usb_otg {
	status = "okay";

	/* Console, shell and logs while OTG owns the USB port. */
	cdc_acm_uart0: cdc_acm_uart0 {
		compatible = "zephyr,cdc-acm-uart";
		label = "ESP-SDR RX API test";
	};
};
```

## src/main.c
```c
/*
 * SPDX-License-Identifier: GPL-3.0-or-later
 *
 * Hardware integration test of the esp_sdr receive API's contract: error
 * codes and boundary values, plus one real capture per supported rate.
 * Runs on the real radio (xiao_esp32s3 or xiao_esp32c6); needs no antenna,
 * peer board or host tool, and never transmits.
 */
#include <errno.h>

#include <zephyr/init.h>
#include <zephyr/ztest.h>

#include <esp_sdr/esp_sdr.h>

#if defined(CONFIG_USB_DEVICE_STACK_NEXT)
#include "app_usb.h"

/*
 * The S3 variant needs a USB shell and DFU to deploy (see Kconfig): start
 * them before ztest's own main() runs the suites below. A SYS_INIT hook,
 * not a competing main() of our own: CONFIG_ZTEST provides main() itself
 * (ztest.c), not merely a weak default one.
 */
static int usb_bringup(void)
{
	(void)app_usb_init();
	return 0;
}
SYS_INIT(usb_bringup, APPLICATION, CONFIG_APPLICATION_INIT_PRIORITY);
#endif

static void *suite_setup(void)
{
#if defined(CONFIG_USB_DEVICE_STACK_NEXT)
	/*
	 * The console is USB CDC-ACM on this variant: ztest's own main() runs
	 * immediately at boot, well before the host has enumerated the
	 * device (and the test suite finishes in milliseconds, so there is
	 * no second chance to reconnect and catch it live). Give the host a
	 * few seconds.
	 */
	k_sleep(K_SECONDS(10));
#endif
	zassert_ok(esp_sdr_init(), "esp_sdr_init() failed");
	zassert_ok(esp_sdr_set_freq(2412), "set_freq(2412) failed");
	return NULL;
}

ZTEST_SUITE(esp_sdr_rx_api, NULL, suite_setup, NULL, NULL, NULL);

ZTEST(esp_sdr_rx_api, test_set_freq_bounds)
{
	zassert_equal(esp_sdr_set_freq(ESP_SDR_FREQ_MIN_MHZ - 1), -EINVAL);
	zassert_equal(esp_sdr_set_freq(ESP_SDR_FREQ_MAX_MHZ + 1), -EINVAL);
	zassert_ok(esp_sdr_set_freq(2412));
	zassert_equal(esp_sdr_get_freq(), 2412);
}

ZTEST(esp_sdr_rx_api, test_set_channel_bw_bounds)
{
	zassert_equal(esp_sdr_set_channel_bw(3), -EINVAL);
	zassert_ok(esp_sdr_set_channel_bw(0));
}

ZTEST(esp_sdr_rx_api, test_capture_rejects_bad_count)
{
	struct esp_sdr_rx_burst b;

	zassert_equal(esp_sdr_rx_capture(ESP_SDR_RATE_80MSPS, ESP_SDR_SAMPLES_MIN - 1, &b),
		      -EINVAL);
	zassert_equal(esp_sdr_rx_capture(ESP_SDR_RATE_80MSPS, ESP_SDR_SAMPLES_MAX + 1, &b),
		      -EINVAL);
}

/* Whichever native rate this SoC does not support (esp_sdr_rx_rate_hz() returns 0 for
 * it) must be rejected outright; which that is varies by SoC (the C6 captures at
 * 80 MS/s only), so ask the library instead of assuming.
 */
ZTEST(esp_sdr_rx_api, test_capture_rejects_unsupported_rate)
{
	static const enum esp_sdr_rate rates[] = {
		ESP_SDR_RATE_80MSPS,
		ESP_SDR_RATE_40MSPS,
		ESP_SDR_RATE_16MSPS,
	};
	struct esp_sdr_rx_burst b;
	bool checked_one = false;

	ARRAY_FOR_EACH(rates, k) {
		if (esp_sdr_rx_rate_hz(rates[k]) == 0U) {
			zassert_equal(esp_sdr_rx_capture(rates[k], 256, &b), -EINVAL,
				      "rate index %u: this SoC does not support it, but capture"
				      " did not reject it",
				      rates[k]);
			checked_one = true;
		}
	}
	if (!checked_one) {
		ztest_test_skip(); /* this SoC supports all three native rates */
	}
}

/* One real capture of the requested length at every rate this SoC supports. */
ZTEST(esp_sdr_rx_api, test_capture_returns_requested_count)
{
	static const enum esp_sdr_rate rates[] = {
		ESP_SDR_RATE_80MSPS,
		ESP_SDR_RATE_40MSPS,
		ESP_SDR_RATE_16MSPS,
	};

	/* Both SoCs capture at 80 MS/s: without it the loop below would test nothing. */
	zassert_true(esp_sdr_rx_rate_hz(ESP_SDR_RATE_80MSPS) > 0U, "80 MS/s reported unsupported");
	ARRAY_FOR_EACH(rates, k) {
		struct esp_sdr_rx_burst b = {0};
		int ret;

		if (esp_sdr_rx_rate_hz(rates[k]) == 0U) {
			continue;
		}
		ret = esp_sdr_rx_capture(rates[k], 1024, &b);
		zassert_ok(ret, "rate index %u: capture failed (%d)", rates[k], ret);
		zassert_equal(b.count, 1024, "rate index %u: got %zu samples, asked for 1024",
			      rates[k], b.count);
		zassert_not_null(b.words, "rate index %u: no sample buffer", rates[k]);
	}
}

ZTEST(esp_sdr_rx_api, test_gain_bounds)
{
	int max = esp_sdr_rx_gain_max();

	zassert_equal(esp_sdr_rx_set_gain(ESP_SDR_RX_GAIN_AUTO - 1), -EINVAL);
	zassert_equal(esp_sdr_rx_set_gain(max + 1), -EINVAL);
	zassert_ok(esp_sdr_rx_set_gain(0));
	zassert_equal(esp_sdr_rx_get_gain(), 0);
	/* Restore the hardware AGC: a later test, or a human on the shell, should not
	 * find the gain stuck at a fixed index this test chose.
	 */
	zassert_ok(esp_sdr_rx_set_gain(ESP_SDR_RX_GAIN_AUTO));
	zassert_equal(esp_sdr_rx_get_gain(), ESP_SDR_RX_GAIN_AUTO);
}

ZTEST(esp_sdr_rx_api, test_lpf_bounds)
{
	zassert_equal(esp_sdr_rx_set_lpf(ESP_SDR_RX_LPF_AUTO - 1), -EINVAL);
	zassert_equal(esp_sdr_rx_set_lpf(ESP_SDR_RX_LPF_MAX + 1), -EINVAL);
	zassert_ok(esp_sdr_rx_set_lpf(0));
	zassert_equal(esp_sdr_rx_get_lpf(), 0);
	zassert_ok(esp_sdr_rx_set_lpf(ESP_SDR_RX_LPF_AUTO)); /* restore */
}

ZTEST(esp_sdr_rx_api, test_bandwidth_bounds)
{
	uint32_t min, max;

	esp_sdr_rx_bandwidth_range(&min, &max);
	zassert_true(min > 0 && max > min, "bandwidth range %u..%u MHz looks wrong", min, max);
	zassert_equal(esp_sdr_rx_set_bandwidth(max + 1), -EINVAL);
	zassert_ok(esp_sdr_rx_set_bandwidth(0)); /* 0: the PHY's own setting, always valid */
	zassert_ok(esp_sdr_rx_set_lpf(ESP_SDR_RX_LPF_AUTO)); /* restore */
}
```
