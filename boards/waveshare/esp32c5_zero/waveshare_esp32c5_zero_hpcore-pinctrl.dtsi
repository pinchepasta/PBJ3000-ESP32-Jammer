/*
 * Copyright (c) 2026 Espressif Systems (Shanghai) Co., Ltd.
 *
 * SPDX-License-Identifier: GPL-3.0-or-later
 *
 * The UART0 group of the ESP32-C5-DevKitC-1 pin control.
 */

#include <zephyr/dt-bindings/pinctrl/esp32c5-pinctrl.h>

&pinctrl {
	/* UART0 on the header's TXD/RXD pins. */
	uart0_default: uart0_default {
		group1 {
			pinmux = <UART0_TX_GPIO11>;
			output-high;
		};

		group2 {
			pinmux = <UART0_RX_GPIO12>;
			bias-pull-up;
		};
	};
};
